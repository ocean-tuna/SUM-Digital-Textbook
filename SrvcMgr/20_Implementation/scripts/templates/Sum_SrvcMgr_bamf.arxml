AUTOSAR XML (schema 00049)
package /RB_Manifest
  build action manifest Sum_SrvcMgr_Manifest
    build action Sum_SrvcMgr_Validate: category=VALIDATOR, invocation=sdg=[true, true], required-environment=com_bosch_configfw_bfwaction_oaw
      input-datas:
        {category=ARTIFACT, sdg=PROCESSOR, engineering-object={short-label=Sum_SrvcMgr_Validate, category=CONFWF, domain=CUBAS, file-type=oaw}}
        category=AR_OBJECT, sdg=DEFAULT_IN, ecuc-definition=SrvcMgr
    build action Sum_SrvcMgr_Generate: category=GENERATOR, invocation=sdg=[1, true, true], predecessor-action=Sum_SrvcMgr_Validate, required-environment=com_bosch_configfw_bfwaction_oaw
      created-datas:
        {category=ARTIFACT, sdg=[MDF, DEFAULT_OUT], engineering-object={short-label=Sum_SrvcMgr_Cfg_SWCD, category=PJTSWCD, domain=CUBAS, file-type=arxml}}
        {category=ARTIFACT, sdg=[MDF, DEFAULT_OUT], engineering-object={short-label=Sum_SrvcMgr_Cfg, category=PJTSRC, domain=CUBAS, file-type=c}}
        {category=ARTIFACT, sdg=[MDF, DEFAULT_OUT], engineering-object={short-label=Sum_SrvcMgr_Cfg, category=PJTSRC, domain=CUBAS, file-type=h}}
        {category=ARTIFACT, sdg=[MDF, DEFAULT_OUT], engineering-object={short-label=Sum_SrvcMgr_Execution_Manager, category=PJTHDR, domain=CUBAS, file-type=c}}
        {category=ARTIFACT, sdg=[MDF, DEFAULT_OUT], engineering-object={short-label=Sum_SrvcMgr_Execution_Manager, category=PJTSRC, domain=CUBAS, file-type=h}}
        {category=ARTIFACT, sdg=[MDF, DEFAULT_OUT], engineering-object={short-label=Sum_SrvcMgr_LearningSession_Manager, category=PJTHDR, domain=CUBAS, file-type=c}}
        {category=ARTIFACT, sdg=[MDF, DEFAULT_OUT], engineering-object={short-label=Sum_SrvcMgr_Service_Manager, category=PJTSRC, domain=CUBAS, file-type=h}}
        {category=ARTIFACT, sdg=[MDF, DEFAULT_OUT], engineering-object={short-label=Sum_SrvcMgr_Service_Manager, category=PJTHDR, domain=CUBAS, file-type=c}}
        {category=ARTIFACT, sdg=[MDF, DEFAULT_OUT], engineering-object={short-label=Sum_SrvcMgr_LearningSession_Manager, category=PJTSRC, domain=CUBAS, file-type=h}}
        {category=ARTIFACT, sdg=[MDF, DEFAULT_OUT], engineering-object={short-label=Sum_SrvcMgr_Calibration_Controller, category=PJTHDR, domain=CUBAS, file-type=c}}
        {category=ARTIFACT, sdg=[MDF, DEFAULT_OUT], engineering-object={short-label=Sum_SrvcMgr_Calibration_Controller, category=PJTSRC, domain=CUBAS, file-type=h}}
        {category=ARTIFACT, sdg=[MDF, DEFAULT_OUT], engineering-object={short-label=Sum_SrvcMgr, category=PJTHDR, domain=CUBAS, file-type=h}}
        {category=ARTIFACT, sdg=[MDF, DEFAULT_OUT], engineering-object={short-label=Sum_SrvcMgr_Prv, category=PJTHDR, domain=CUBAS, file-type=h}}
        {category=ARTIFACT, sdg=[MDF, DEFAULT_OUT], engineering-object={short-label=Sum_SrvcMgr_Initialization, category=PJTHDR, domain=CUBAS, file-type=c}}
        {category=ARTIFACT, sdg=[MDF, DEFAULT_OUT], engineering-object={short-label=Sum_SrvcMgr_Initialization, category=PJTSRC, domain=CUBAS, file-type=h}}
        {category=ARTIFACT, sdg=[MDF, DEFAULT_OUT], engineering-object={short-label=Sum_SrvcMgr_Types, category=PJTSRC, domain=CUBAS, file-type=h}}
      input-datas:
        {category=ARTIFACT, sdg=PROCESSOR, engineering-object={short-label=Sum_SrvcMgr_Generate, category=CONFWF, domain=CUBAS, file-type=oaw}}
        category=AR_OBJECT, sdg=DEFAULT_IN, ecuc-definition=SrvcMgr
