AUTOSAR XML (schema 00049)
# COPYRIGHT RESERVED, 2020 ETAS GmbH. All rights reserved.
# The reproduction, distribution and utilization of this document as well as
# the communication of its contents to others without explicit authorization
# is prohibited. Offenders will be held liable for the payment of damages.
# All rights reserved in the event of the grant of a patent, utility model or
# design.
package /AUTOSAR
  module definition SrvcMgr [0..1]: refined-module-def=SrvcMgr, variants pre-compile/post-build  # Configuration of the Service Manager module.
    container Sum_SrvcMgr_General  # General configuration parameters of the Service Manager.
      integer Sum_SrvcMgr_PermitExecutionMask [0..1]: 0..255, set at pre-compile in variant pre-compile / post-build in variant post-build, origin=ETAS:1.0.0:2015-05-04  # PermitExecution mask to start execution of the SrvcMgr sub-module.
      float Sum_SrvcMgr_ExecutionManagerPeriodicity: 1..65535, set at pre-compile in variant pre-compile / post-build in variant post-build, origin=ETAS:1.0.0:2015-05-04, default-value=100  # SrvcMgrMainFunctionPeriod | Period (ms) of the Execution Manager Runnable. Handling internal modes and shutdown procedure.
      boolean Sum_SrvcMgr_GenerateInitRunnable: set at pre-compile in variant pre-compile / post-build in variant post-build, origin=RB:0.1.0:2015-12-05, default-value=false  # Configuration parameter Sum_SrvcMgr_GenerateInitRunnable is used to allow the generation of a periodic runnable to run function RE_SrvcMgr_Init one time. If TRUE the SrvcMgr should generate the periodic runnable to execute init() function one time otherwise, the init() function is called by a BswM action list during startup.
      float Sum_SrvcMgr_InitFuncPeriodicity [0..1]: 1.0..5000.0, set at pre-compile in variant pre-compile / post-build in variant post-build, origin=ETAS:1.0.0:2015-05-04, default-value=1000.0  # Specifies time in milisecond, for the periodicity of the runnable RE_SrvcMgr_Init. Float values are supported. This parameter is required when Sum_SrvcMgr_GenerateInitRunnable is set to TRUE
    container Sum_SrvcMgr_ConfigSet  # SrvcMgrConfigSet subcontainer.
      container Sum_SrvcMgr_DcmReferences  # SrvcMgrDcmReferences | DCM References.
        reference Sum_SrvcMgr_Did_E0CC_Ref: set at pre-compile, destination=DcmDspDid  # Reference to DID E0CC for retrieving the Learning Table Status
        reference Sum_SrvcMgr_Did_E0CD_Ref: set at pre-compile, destination=DcmDspDid  # Reference to DID E0CD for retrieving the Incomplete Learning Table - Client section
        reference Sum_SrvcMgr_Did_E0CE_Ref: set at pre-compile, destination=DcmDspDid  # Reference to DID E0CE for retrieving the Incomplete Learning Table - Server section
        reference Sum_SrvcMgr_Rid_0654_Ref: set at pre-compile, destination=DcmDspRoutine  # Reference to RID 0654 for triggering Learning Session
        reference Sum_SrvcMgr_Rid_0612_Ref: set at pre-compile, destination=DcmDspRoutine  # Reference to RID 0612 to Retrieve Learning Table content.
        choice reference Sum_SrvcMgr_Sig_PropSysActv_Ref: set at pre-compile, destination=[ComGroupSignal, ComSignal]  # Foreign reference to the Com Signal for Propulsion System Active. This signal can be configured as a single signal or as a signal belonging to a group of signals.
        foreign reference Sum_SrvcMgr_ServiceBased_DataTypeMappingSet [0..*]: destination-type=DATA-TYPE-MAPPING-SET  # Foreign reference to the DATA-TYPE-MAPPING-SET in the system extract used for service-based operations. This parameter references the system data type mapping sets that define the structure and format for PSA and Vehicle Speed service-based functionality and data transformations.
        foreign reference Sum_SrvcMgr_ServiceBased_PropSysActv_Ref [0..1]: set at pre-compile, origin=RB, destination-type=IMPLEMENTATION-DATA-TYPE-ELEMENT  # Foreign reference to the IMPLEMENTATION-DATA-TYPE for Service-Based PSA Propulsion System Active from System Extract from Software-AR-Packages
        choice reference Sum_SrvcMgr_Sig_VehSpdAvgDrvn_Ref: set at pre-compile, destination=[ComGroupSignal, ComSignal]  # Foreign reference to the Com Signal for Vehicle Speed Average Driven. This signal can be configured as a single signal or as a signal belonging to a group of signals.
        foreign reference Sum_SrvcMgr_ServiceBased_VehSpdAvgDrvn_Ref [0..1]: set at pre-compile, origin=RB, destination-type=IMPLEMENTATION-DATA-TYPE-ELEMENT  # Foreign reference to the IMPLEMENTATION-DATA-TYPE for Service-Based Vehicle Speed Average Driven from System Extract from Software-AR-Packages
