AUTOSAR XML (schema 4-0-3)
package /ASW_SUM_LNM
  module definition LNM [0..1]: refined-module-def=LNM, variants post-build  # Configuration of the LNM (Lin Network Manager) module.
    container LNM_General  # General configuration parameters of SUM_LNM.
      float LNM_MainFunction_Period: 0.001..0.2, set at pre-compile, origin=GM_ECUC, default-value=0.1  # Time in sec, for the periodicity of the MainFunction runnable
      float LNM_NetworkStatus_Period: 0.001..0.2, set at pre-compile, origin=GM_ECUC, default-value=0.1  # Time in sec, for the periodicity of the NetworkStatus
      float LNM_ScheduleManagement_Period: 0.001..0.2, set at pre-compile, origin=GM_ECUC, default-value=0.1  # Time in sec, for the periodicity of the ScheduleManagement
      float LNM_NetworkFaultManager_Period: 0.001..0.2, set at pre-compile, origin=GM_ECUC, default-value=0.1  # Time in sec, for the periodicity of the NetworkFaultManager
      integer LNM_PermitExecution_Mask: set at pre-compile, origin=GM_ECUC, default-value=254  # Mask that is checked by SUM_LNM to execute its functions
      integer LNM_TWuDelay_Commander: 0..200, set at pre-compile in variant pre-compile / post-build in variant post-build, origin=ETAS:1.0.0:2015-05-04, default-value=100  # Delay in millisecond before schedule activation when wakeup has been requested by the Commander
      integer LNM_TWuDelay_Responder: 0..200, set at pre-compile in variant pre-compile / post-build in variant post-build, origin=ETAS:1.0.0:2015-05-04, default-value=100  # Delay in millisecond before schedule activation when wakeup has been requested by the Responder
      integer LNM_WupTxRetries_Commander: 0..255, set at pre-compile in variant pre-compile / post-build in variant post-build, origin=ETAS:1.0.0:2015-05-04, default-value=10  # Init value of calibration parameter. Number of retries before notification of Loss of Communication with Bus, when transitioning from NO COMM to FULL COMM
      boolean CyberFill_Supported: set at pre-compile, origin=GM_ECUC, default-value=false  # Enable the CyberFill value support
      integer LNM_CyberFillValue [0..1]: set at pre-compile, origin=GM_ECUC, default-value=0  # CyberFill value provided by SUM_LNM at initialization time
      boolean LnmGenerateInitRunnable: set at pre-compile, origin=GM_ECUC, default-value=false  # The configuration parameter is used to allow the generation of a periodic runnable to run function Runnable_Lnm_Init one time. If TRUE the Lnm should generate the periodic runnable to execute init() function one time otherwise, the init() function is called by a BswM action list during startup.
      float LnmInitFuncPeriodicity [0..1]: 1.0..5000.0, set at pre-compile, origin=GM_ECUC, default-value=1000.0  # Specifies time in milisecond, for the periodicity of the runnable RE_Lnm_Init. Float values are supported. This parameter is required when LnmGenerateInitRunnable is set to TRUE.
      boolean Sum_Lnm_ConfGen_Enabled: set at pre-compile, origin=GM_ECUC, default-value=false  # If false it's enabling the generation of Sum_Lnm_SWCD.arxml, if true the ConfGen will generate that file.
      boolean Sum_Lnm_ScheduleChannelUserFuncs_Enabled: set at pre-compile, origin=GM_ECUC, default-value=false  # Enable the use of user functions for changing the Schedule Table and Channel State for the LIN network.
      boolean lNM_C_DTC_LostCommWithLinResp_Enabled: set at pre-compile, origin=GM_ECUC, default-value=true  # Initial value for the calibration parameter controlling whether to enable the Lost Communication with LIN Responder Device DTC. Setting this parameter to true will let LNM aggregate the DTC.
      reference LNM_DID_F1BE_Reference: set at pre-compile in variant pre-compile / post-build in variant post-build, origin=ETAS:1.1.0:2015-07-15, destination=DcmDspDid  # Reference to the Dcm service for DID F1BE
    container LNM_Arbitration [0..1]  # Configuration for LNM arbitration
      container LNM_Inputs [0..1]  # Configuration of LNM inputs
        container LNM_ScheduleSignal [0..*]  # Configuration of LNM schedule signal
          enumeration LNM_ScheduleSignalSource [0..1]: {SWC, Com, VPM}, set at pre-compile in variant pre-compile / post-build in variant post-build, origin=ETAS:1.0.0:2015-05-04, default-value=SWC  # Source definition of the schedule signal
          enumeration LNM_ScheduleSignalType [0..1]: {boolean, uint8, uint16}, set at pre-compile in variant pre-compile / post-build in variant post-build, origin=ETAS:1.0.0:2015-05-04, default-value=uint8  # Definition of the schedule signal type
      container LNM_Conditions [0..1]  # Configuration of LNM conditions
        container LNM_Condition [1..*]  # Configuration of LNM project specific conditions
          enumeration LNM_CompareOperator [0..1]: {==, !=, <, >, <=, >=}, set at pre-compile in variant pre-compile / post-build in variant post-build, origin=ETAS:1.0.0:2015-05-04, default-value===  # Definition of the compare operation
          integer LNM_CompareValue [0..1]: 0..65535, set at pre-compile in variant pre-compile / post-build in variant post-build, origin=ETAS:1.0.0:2015-05-04, default-value=0  # Definition of the value that is compared with the input
          enumeration LNM_CompareVPMValue [0..1]: {OFF, ACCESSORY, RUN, STARTREQUEST, PROPULSION, TRANSPORT}, set at pre-compile in variant pre-compile / post-build in variant post-build, origin=ETAS:1.0.0:2015-05-04  # Definition of the compare operation for VPM
          reference LNM_InputRef [0..1]: set at pre-compile in variant pre-compile / post-build in variant post-build, origin=ETAS:1.1.0:2015-07-15, destination=LNM_ScheduleSignal  # Reference to the input that must be compared
      container LNM_Rules [0..1]  # Configuration of LNM rules
        container LNM_Rule [0..*]  # Configuration of LNM project specific rules
          enumeration LNM_LogicOperator [0..1]: {&, |}, set at pre-compile in variant pre-compile / post-build in variant post-build, origin=ETAS:1.0.0:2015-05-04, default-value=&  # Definition of the logic operator that relates the conditions
          choice reference LNM_ConditionRef [0..*]: set at pre-compile in variant pre-compile / post-build in variant post-build, origin=ETAS:1.1.0:2015-07-15, destination=[LNM_Condition, LNM_Rule]  # Reference to the conditions or rules used to compone complex logic functions
    container LNM_Networks  # Configuration of the system LIN Networks
      container LNMNetwork [0..*]  # LNM network configuration
        container LNM_Responders [1..*]  # Configuration of Responders associated to the network
          enumeration LNM_MSCL_ByteIndex: {MSCL_BYTE_1, MSCL_BYTE_2}, set at pre-compile in variant pre-compile / post-build in variant post-build, origin=ETAS:1.0.0:2015-05-04, default-value=MSCL_BYTE_1  # Configuration of the byte of the MSCL related to the selected Responder
          integer LNM_MSCL_BitIndex: 0..7, set at pre-compile in variant pre-compile / post-build in variant post-build, origin=ETAS:1.0.0:2015-05-04, default-value=0  # Configuration of the bit index of the MSCL related to the selected Responder. It can range from 0 to 7.
          boolean LNM_C_ResponderPresent_InitValue [0..1]: set at pre-compile, origin=GM_ECUC, default-value=true  # If MSCL via Calibration is configured, this parameter indicates the initial value of the calibration parameter
          integer LNM_LossOfComm_withDevice_Timer: 0..65535, set at pre-compile in variant pre-compile / post-build in variant post-build, origin=ETAS:1.0.0:2015-05-04, default-value=0  # Configuration of the timer for ERRH debouncing of Loss of Communication with Device.
          boolean LNM_Internal_Electronic_Failure_Supported: set at pre-compile, origin=GM_ECUC, default-value=false  # Select if the selected Responder supports the Internal Electronic Failure DTC
          boolean LNM_IEF_APINFO2_Supported [0..1]: set at pre-compile, origin=GM_ECUC, default-value=false  # If Internal Electronic Failure DTC is supported, select if APINFO2 (Reset Status) to detect fault condition is supported
          integer LNM_IEF_Reset_Threshold [0..1]: 1..255, set at pre-compile in variant pre-compile / post-build in variant post-build, origin=ETAS:1.0.0:2015-05-04, default-value=3  # If APINFO2 is supported to set Internal Electronic Failure DTC, set the threshold of reset notification that are accepted before setting the DTC
          boolean LNM_IEF_APINFO4_Supported [0..1]: set at pre-compile, origin=GM_ECUC, default-value=false  # If Internal Electronic Failure DTC is supported, select if APINFO4 (Application Status) to detect fault condition is supported
          boolean LNM_Responder_Device_Not_Configured_Supported: set at pre-compile, origin=GM_ECUC, default-value=false  # Select if the current Responder supports the LIN Responder Device Not Configured DTC. It requires APINFO3 signal support
          integer LNM_Config_Retries [0..1]: 0..7, set at pre-compile in variant pre-compile / post-build in variant post-build, origin=ETAS:1.0.0:2015-05-04, default-value=3  # Number of retries for configuration of the Responder before Responder Device Not Configured is set
        container LNM_ScheduleManagement [0..1]  # LNM network configuration
          container LNM_ScheduleStates [0..1]  # Configuration of schedule states of the specific network
            container LNM_ScheduleState [0..*]  # Configuration of schedule state of the specific network
              choice reference LNM_ScheduleRef [0..1]: set at pre-compile in variant pre-compile / post-build in variant post-build, origin=ETAS:1.1.0:2015-07-15, destination=[LinSMSchedule, LinSMSchedule]  # Reference to the LinSM schedule associated to the state
            container LNM_StartState [0..1]  # Configuration of schedule start state
            container LNM_SleepState [0..1]  # Configuration of schedule sleep state
          container LNM_ScheduleTransitions [0..1]  # Configuration of schedule transitions of the specific network
            container LNM_ScheduleTransition [0..*]  # Configuration of schedule transition of the specific network
              choice reference LNM_StartStateRef [0..1]: set at pre-compile in variant pre-compile / post-build in variant post-build, origin=ETAS:1.1.0:2015-07-15, destination=[LNM_ScheduleState, LNM_StartState, LNM_SleepState]  # Reference to the starting state of the transition
              choice reference LNM_EndStateRef [0..1]: set at pre-compile in variant pre-compile / post-build in variant post-build, origin=ETAS:1.1.0:2015-07-15, destination=[LNM_ScheduleState, LNM_StartState, LNM_SleepState]  # Reference to the end state of the transition
              reference LNM_TransitionRuleRef [0..1]: set at pre-compile in variant pre-compile / post-build in variant post-build, origin=ETAS:1.1.0:2015-07-15, destination=LNM_Rule  # Reference the rule used to activate the state transition
        integer LNM_Network_ID: 1..16, set at pre-compile in variant pre-compile / post-build in variant post-build, origin=ETAS:1.0.0:2015-05-04, default-value=1  # Network ID that ranges from 1 to 16. Needed for F1BE DID
        enumeration LNM_MSCL_Strategy: {Calibration, Evaluation}, set at pre-compile in variant pre-compile / post-build in variant post-build, origin=ETAS:1.0.0:2015-05-04, default-value=Calibration  # Define the strategy used by the ECU for the MSCL. MSCL via Calibration or Evaluation. For more information please refer to the user guide.
        boolean LNM_ChannelEnable_InitValue: set at pre-compile, origin=GM_ECUC, default-value=true  # Init value for the calibration parameter that enables the execution of the MSCL
        enumeration LNM_ActivationSignalType [0..1]: {SWC, Com, Rule}, set at pre-compile in variant pre-compile / post-build in variant post-build, origin=ETAS:1.0.0:2015-05-04, default-value=SWC  # Source definition of the activation signal
        integer LNM_ActivationMask [0..1]: 0..255, set at pre-compile in variant pre-compile / post-build in variant post-build, origin=ETAS:1.0.0:2015-05-04  # Activation bit mask to select relevant bits for channel activation
        integer LNM_DeactivationMask [0..1]: 0..255, set at pre-compile in variant pre-compile / post-build in variant post-build, origin=ETAS:1.0.0:2015-05-04  # Deactivation bit mask to select relevant bits for channel deactivation
        boolean LNM_C_DTC_LINBusOff: set at pre-compile, origin=GM_ECUC, default-value=false  # Parameter that enables the DTC for LIN Bus off.
        integer LNM_C_PreSleepDelay: 0..4000, set at pre-compile in variant pre-compile / post-build in variant post-build, origin=ETAS:1.0.0:2015-05-04, default-value=25  # Calibration parameter for Time in ms, indicates the delay from the instance the schedule switching criteria is satisfied to transition from a RUN_ONCE or a RUN_CONTINUOUS FULL_COMM state to a NO_COMM state, until the transition to the NULL schedule occurs when the SLEEP command is issued.
        reference Sum_LNM_LinSMNetworkId_ref [0..1]: set at pre-compile in variant pre-compile / post-build in variant post-build, origin=ETAS:1.1.0:2015-07-15, destination=LinSMChannel  # Reference to the unique LIN network index
        reference Sum_LNM_Rule_ref [0..1]: set at pre-compile in variant pre-compile / post-build in variant post-build, origin=ETAS:1.1.0:2015-07-15, destination=LNM_Rule  # Reference to the activation rule
