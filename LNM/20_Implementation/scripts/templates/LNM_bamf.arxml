AUTOSAR XML (schema 00049)
package /RB_Manifest
  build action manifest LNM_Manifest
    build action LNM_Generate: category=GENERATOR, invocation=sdg=[1, true, true, RBA-BSW], predecessor-action=LNM_Validate, required-environment=com_bosch_configfw_bfwaction_oaw
      created-datas:
        {category=ARTIFACT, sdg=[MDF, DEFAULT_OUT], engineering-object={short-label=SUM_LNM_PBCfg, category=PJTSRC, domain=CUBAS, file-type=c}}
        {category=ARTIFACT, sdg=[MDF, DEFAULT_OUT], engineering-object={short-label=SUM_LNM_Cfg, category=PJTSRC, domain=CUBAS, file-type=c}}
        {category=ARTIFACT, sdg=[MDF, DEFAULT_OUT], engineering-object={short-label=SUM_LNM_Cfg, category=PJTHDR, domain=CUBAS, file-type=h}}
        {category=ARTIFACT, sdg=[MDF, DEFAULT_OUT], engineering-object={short-label=SUM_LNM_PBCfg, category=PJTHDR, domain=CUBAS, file-type=h}}
        {category=ARTIFACT, sdg=[MDF, DEFAULT_OUT], engineering-object={short-label=Sum_Lnm_Cfg_SWCD, category=PJTSWCD, domain=CUBAS, file-type=arxml}}
        {category=ARTIFACT, sdg=[MDF, DEFAULT_OUT], engineering-object={short-label=Sum_Lnm_SWCD*, category=PJTSWCD, domain=CUBAS, file-type=arxml}}
      input-datas:
        {category=ARTIFACT, sdg=PROCESSOR, engineering-object={short-label=LNM_generator, category=CONFWF, domain=CUBAS, file-type=oaw}}
        category=AR_OBJECT, sdg=DEFAULT_IN, ecuc-definition=LNM
    build action LNM_Validate: category=VALIDATOR, invocation=sdg=[1, true, true, true], required-environment=com_bosch_configfw_bfwaction_oaw
      input-datas:
        {category=ARTIFACT, sdg=PROCESSOR, engineering-object={short-label=LNM_Validate, category=CONFWF, domain=CUBAS, file-type=oaw}}
        category=AR_OBJECT, sdg=DEFAULT_IN, ecuc-definition=LNM
        category=AR_OBJECT, sdg=DEFAULT_IN, ecuc-definition=ComM
        category=AR_OBJECT, sdg=DEFAULT_IN, ecuc-definition=Com
        category=MSR_OBJECT, sdg=DEFAULT_IN, ecuc-definition=Dcm
        category=MSR_OBJECT, sdg=DEFAULT_IN, ecuc-definition=LinSM
