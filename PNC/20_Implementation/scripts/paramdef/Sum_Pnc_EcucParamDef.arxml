AUTOSAR XML (schema 4-0-3)
# COPYRIGHT RESERVED, 2020 ETAS GmbH. All rights reserved.
# The reproduction, distribution and utilization of this document as well as
# the communication of its contents to others without explicit authorization
# is prohibited. Offenders will be held liable for the payment of damages.
# All rights reserved in the event of the grant of a patent, utility model or
# design.
package /AUTOSAR_PNC/EcucModuleDefs
  ecuc definition collection GM_PNC_AUTOSARParameterDefinition: module=PNC
  module definition PNC [0..1]: variants post-build/pre-compile  # This container holds the configuration of a PNC module.
    container PNCConfigSet  # This container contains the parameters related each CAN Driver Unit.
      container SUM_PNC_PARTIAL_NETWORK_PARAMETER [1..*]  # This container contains the parameters related each CAN Driver Unit.
        boolean IsRxEnabled: set at pre-compile, default-value=true  # Specifies if the RxPDU and RxPduGroup Interfaces are available for the PN or not. TRUE will create interfaces for for SSFM and BswM.
        boolean IsTxEnabled: set at pre-compile, default-value=true  # Specifies if the TxPDU and TxPduGroup Interfaces are available for the PN or not. TRUE will create interfaces for for SSFM and BswM.
        integer Number_of_PNC_Activation_Sensors: 0..255, set at pre-compile, default-value=1  # Specifies Number_of_PNC_Activation_Sensors per PN .
        integer Number_of_PNC_Activation_Signals: 0..255, set at pre-compile, default-value=1  # Specifies Number_of_PNC_Activation_Signals per PN.
        integer SUM_PN_DM_Timer: 0..8000, set at pre-compile, default-value=7000  # Time in msec, for the PNC to requestDeactivation of the deadline monitoring associated with Rx PDU group of each PN
        integer SUM_PN_DTC_TIMER: 0..5000, set at pre-compile in variant pre-compile / post-build in variant post-build, origin=RB:0.1.0:2015-12-05, default-value=5000  # Init value in milliseconds frequency for the SUM_PN_DTC_TIMER
        enumeration PartialNetworkName [0..1]: {All Nodes, Wireless Charging, Short Duration Event, Diagnose Mechatronics Ethernet, Any Diagnose CAN PN}, set at pre-compile in variant pre-compile / post-build in variant post-build  # Name of the Partial Network. Among the possible choices: 0x21= All Nodes, 0x22= Wireless Charging, 0x23= Short Duration Event, 0x24= Diagnose Mechatronics. 0x25=SDV2 Any Diagnose CAN PN
        reference ComM_PNC_Ref: set at pre-compile, destination=ComMPnc, destination=ComMPnc
        choice reference Repeat_Message_Time_Ref: set at pre-compile, destination=[CanNmChannelConfig, CanNmChannelConfig, UdpNmChannelConfig, UdpNmChannelConfig]  # This parameter is reference parameter for CanNm/UdpNm parameter CanNmRepeatMessageTime/UdpNmRepeatMessageTime which provides Timeout for Repeat Message State
    container PNCGeneral  # This container contains the General parameters related to PNC module as per spec.
      integer SUM_PNC_ACTIVE_SYNCH_TIME: 0..100, set at pre-compile, default-value=60  # Specifies Time in msec, for the PNC to request the PN Tx PDU group activation, after detecting that the activation criteria is met and after the activation of the Rx PDU group activation.
      integer SUM_PNC_PASSIVE_SYNCH_TIME: 0..100, set at pre-compile, default-value=10  # Specifies Time in msec, for the PNC to request the PN Tx PDU group activation, after detecting remote activation and after the activation of the Rx PDU group activation.
      enumeration Sum_PNC_Local_RecordID_Type: {Enumerated, BitMapped}, set at pre-compile in variant pre-compile / post-build in variant post-build, default-value=Enumerated  # Indicator of record store type for local PN.
      float PNC_t_RemoteSignals_Periodicity: 1..100, set at pre-compile, default-value=12.50  # Specifies Time in msec, for the periodicity of polling for changes to Activation Signals
      float PNC_t_MainFunction_Periodicity: 1..100, set at pre-compile, default-value=12.50  # Specifies Time in msec, for the periodicity of polling for changes to PNC state changes. Float values are supported
      float PNC_t_PNsPNsStatusMonitoring_Periodicity: 1..100, set at pre-compile, default-value=12.5  # Time in msec, for the periodicity of monitoring for changes to the PN status
      float Shutdown_permission_SUSD_Periodicity: 1..100, set at pre-compile, default-value=10.0  # Time in msec, for the periodicity of "Shutdown_permission_SUSD" runnable.
      integer PNC_t_Activation_Req_Timer: 1..100, set at pre-compile, default-value=10  # Time in msec, to verify PN Activation after mode request (for retry purpose)
      integer PNC_PermitExecution_Mask: 0..255, set at pre-compile, default-value=190  # Mask that can be OR'd with the value supplied by PermitExecution to set any "don't care" bits to '1'.
      integer Number_of_Retries: 0..50, set at pre-compile, default-value=1  # Number_of_Retries.
      integer SUM_PN_Coordinator_Node_ID: 0..255, set at pre-compile, default-value=69  # ECU ID (part of NM PDU) associated with CGM that is used for deadline monitoring control (used with SUM_PN_n_DM_Timer). Value in DECIMAL.
      boolean AR_GMSUM_4_2_X_SUPPORT: set at post-build, origin=RB:0.1.0:2015-12-05, default-value=1  # This parameter is used to distinguish between the AR ComM V4.0.3 and V4.1.1and above. If AR ComM V4.0.3 is used, ComMPncId will be configured in range of 0-47, for V4.1.1 and above, range is 8-63
      boolean PncGenerateInitRunnable: set at post-build, default-value=false  # It allows the generation of a periodic runnable that calls the initialization function SUM_PNC_Init only the first time it is invoked
      float PncInitFuncPeriodicity [0..1]: 1.0..5000.0, set at post-build, default-value=1000.0  # It is used to specify the periodicity, in milliseconds, of the initialization runnable entity Runnable_Pnc_Init
      boolean ComMPncIdLongRangeSupport: set at pre-compile in variant pre-compile / post-build in variant post-build, default-value=true  # This parameter is used to distinguish the range values that can be assigned to ComMPncId. If it is true the first comMPncId starts from 0, otherwise it starts from 16
      reference SSFMConfigSet_Ref [0..1]: set at pre-compile in variant pre-compile / post-build in variant post-build, destination=Sum_Ssfm_ConfigSet  # Reference to the SSFMConfigSet container of the SSFM.
      container ComM_PNC_Channel [1..8]  # List of all ComM PNC Channels available for this system.
        integer CAN_Channel_Number: 0..7, set at pre-compile, default-value=0  # This parameter will configure the CAN number with associated ComM channel reference.
        reference ComM_Channel_Ref: set at pre-compile, destination=ComMChannel, destination=ComMChannel
