AUTOSAR XML (schema 00049)
package /RB_Manifest
  build action manifest Sum_Pnc_Manifest
    build action Sum_Pnc_Validate: category=VALIDATOR, invocation=sdg=[true, true], required-environment=com_bosch_configfw_bfwaction_oaw
      input-datas:
        {category=ARTIFACT, sdg=PROCESSOR, engineering-object={short-label=Sum_Pnc_Validate, category=CONFWF, domain=CUBAS, file-type=oaw}}
        category=AR_OBJECT, sdg=DEFAULT_IN, ecuc-definition=PNC
    build action Sum_Pnc_Generate: category=GENERATOR, invocation=sdg=[1, true, true], predecessor-action=Sum_Pnc_Validate, required-environment=com_bosch_configfw_bfwaction_oaw
      created-datas:
        {category=ARTIFACT, sdg=[MDF, DEFAULT_OUT], engineering-object={short-label=Sum_Pnc_Cfg_SWCD, category=PJTSWCD, domain=CUBAS, file-type=arxml}}
        {category=ARTIFACT, sdg=[MDF, DEFAULT_OUT], engineering-object={short-label=Sum_Pnc_PBCfg, category=PJTSRC, domain=CUBAS, file-type=c}}
        {category=ARTIFACT, sdg=[MDF, DEFAULT_OUT], engineering-object={short-label=Sum_Pnc_Cfg, category=PJTHDR, domain=CUBAS, file-type=h}}
        {category=ARTIFACT, sdg=[MDF, DEFAULT_OUT], engineering-object={short-label=Sum_Pnc_Cfg, category=PJTSRC, domain=CUBAS, file-type=c}}
        {category=ARTIFACT, sdg=[MDF, DEFAULT_OUT], engineering-object={short-label=Sum_Pnc_PBCfg, category=PJTHDR, domain=CUBAS, file-type=h}}
        {category=ARTIFACT, sdg=[MDF, DEFAULT_OUT], engineering-object={short-label=Sum_Pnc_Autosar_Runnable, category=PJTSRC, domain=CUBAS, file-type=c}}
        {category=ARTIFACT, sdg=[MDF, DEFAULT_OUT], engineering-object={short-label=Sum_Pnc_Main, category=PJTSRC, domain=CUBAS, file-type=c}}
        {category=ARTIFACT, sdg=[MDF, DEFAULT_OUT], engineering-object={short-label=Sum_Pnc, category=PJTHDR, domain=CUBAS, file-type=h}}
        {category=ARTIFACT, sdg=[MDF, DEFAULT_OUT], engineering-object={short-label=Sum_Pnc_Ram, category=PJTHDR, domain=CUBAS, file-type=h}}
      input-datas:
        {category=ARTIFACT, sdg=PROCESSOR, engineering-object={short-label=Sum_Pnc_Generate, category=CONFWF, domain=CUBAS, file-type=oaw}}
        category=AR_OBJECT, sdg=DEFAULT_IN, ecuc-definition=PNC
