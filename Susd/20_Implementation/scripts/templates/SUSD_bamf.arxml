AUTOSAR XML (schema 00049)
package /RB_Manifest
  build action manifest SUSD_Manifest
    build action SUSD_Validate: category=VALIDATOR, invocation=sdg=[true, true], required-environment=com_bosch_configfw_bfwaction_oaw
      input-datas:
        {category=ARTIFACT, sdg=PROCESSOR, engineering-object={short-label=SUSD_Validate, category=CONFWF, domain=CUBAS, file-type=oaw}}
        category=AR_OBJECT, ecuc-definition=SUSD
    build action SUSD_Generator: category=GENERATOR, invocation=sdg=[1, true, FALSE], predecessor-action=SUSD_Validate, required-environment=com_bosch_configfw_bfwaction_oaw
      created-datas:
        {category=ARTIFACT, sdg=[MDF, DEFAULT_OUT], engineering-object={short-label=SUM_SUSD_Cfg, category=PJTSRC, domain=CUBAS, file-type=c}}
        {category=ARTIFACT, sdg=[MDF, DEFAULT_OUT], engineering-object={short-label=SUM_SUSD_Cfg, category=PJTHDR, domain=CUBAS, file-type=h}}
        {category=ARTIFACT, sdg=[MDF, DEFAULT_OUT], engineering-object={short-label=SUM_SUSD, category=PJTHDR, domain=CUBAS, file-type=h}}
        {category=ARTIFACT, sdg=[MDF, DEFAULT_OUT], engineering-object={short-label=SUM_SUSD_SWCD, category=PJTSWCD, domain=CUBAS, file-type=arxml}}
        {category=ARTIFACT, sdg=[MDF, DEFAULT_OUT], engineering-object={short-label=SUM_SUSD_PBcfg, category=PJTSRC, domain=CUBAS, file-type=c}}
        {category=ARTIFACT, sdg=[MDF, DEFAULT_OUT], engineering-object={short-label=SUM_SUSD_PBcfg, category=PJTHDR, domain=CUBAS, file-type=h}}
        {category=ARTIFACT, sdg=[MDF, DEFAULT_OUT], engineering-object={short-label=SUM_SUSD_DID, category=PJTSRC, domain=CUBAS, file-type=c}}
        {category=ARTIFACT, sdg=[MDF, DEFAULT_OUT], engineering-object={short-label=SUM_SUSD_E0D7_Handler, category=PJTSRC, domain=CUBAS, file-type=c}}
        {category=ARTIFACT, sdg=[MDF, DEFAULT_OUT], engineering-object={short-label=SUM_SUSD_E0D7_Handler, category=PJTSRC, domain=CUBAS, file-type=h}}
      input-datas:
        {category=ARTIFACT, sdg=PROCESSOR, engineering-object={short-label=SUSD_generator, category=CONFWF, domain=CUBAS, file-type=oaw}}
        category=AR_OBJECT, sdg=DEFAULT_IN, ecuc-definition=SUSD
