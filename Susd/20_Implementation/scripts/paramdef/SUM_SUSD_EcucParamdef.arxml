AUTOSAR XML (schema 4-0-3)
# COPYRIGHT RESERVED, 2019 ETAS GmbH. All rights reserved.
# The reproduction, distribution and utilization of this document as well as the communication of
# its contents to others without explicit authorization is prohibited. Offenders will be held
# liable for the payment of damages. All rights reserved in the event of the grant of a patent,
# utility model or design.
package /ASW_SUM_SUSD
  module definition SUSD [0..1]  # Configuration of the SUSD (Start Up Shut Down) module.
    container SUSDConfigSet  # This container contains the configuration parameters and sub containers of the SUSD module supporting multiple configuration sets.
      integer SUSD_C_DisableNVMWrite_Voltage: 0..9, set at pre-compile, origin=GM_ECUC, default-value=5  # A calibration parameter SUSD indicates to SW-Cs to disable any NVM write processes, if the battery voltage is below this value
      float SUSD_C_PerToVoltageConvFactor: 0..26.5, set at pre-compile, origin=GM_ECUC, default-value=26.5  # A calibration parameter for Percentage to Voltage Conversion Factor
      boolean SUSD_C_RunCrankInputStuckHi_Enable: set at pre-compile, origin=GM_ECUC, default-value=true  # This calibration enables the Run Crank Stuck High Diagnostic if set to true else disables
      integer SUSD_C_RunCrankInputStuckHi_FailCount: 0..65535, set at pre-compile, origin=GM_ECUC, default-value=16  # This calibration defines the maximum value of the fault maturation’s failure counter for Run Crank Input Stuck High
      integer SUSD_C_RunCrankInputStuckHi_SampleCount: 0..65535, set at pre-compile, origin=GM_ECUC, default-value=20  # This calibration defines the maximum value of the fault maturation’s sample counter for Run Crank Input Stuck High
      boolean SUSD_C_RunCrankInputStuckLow_Enable: set at pre-compile, origin=GM_ECUC, default-value=true  # This calibration enables the Run Crank Stuck Low Diagnostic if set to true else disables
      integer SUSD_C_RunCrankInputStuckLow_FailCount: 0..65535, set at pre-compile, origin=GM_ECUC, default-value=16  # This calibration defines the maximum value of the fault maturation’s failure counter for Run Crank Input Stuck Low
      integer SUSD_C_RunCrankInputStuckLow_SampleCount: 0..65535, set at pre-compile, origin=GM_ECUC, default-value=20  # This calibration defines the maximum value of the fault maturation’s sample counter for Run Crank Input Stuck Low
      float SUSD_C_RunCrankInputThresholdHigh: 0..26.5, set at pre-compile, origin=GM_ECUC, default-value=5  # This calibration parameter is used for Run Crank Input High(RunCrank Active High) determination based on this threshold voltage
      float SUSD_C_RunCrankInputThresholdLow: 0..26.5, set at pre-compile, origin=GM_ECUC, default-value=2  # This calibration parameter is used for Run Crank Input Low(RunCrank Active Low) determination based on this threshold voltage
      float SUSD_C_RunCrankInput_DebounceTime: 0.0..10.0, set at pre-compile, origin=GM_ECUC, default-value=0.03  # Time in sec, Duration used for Analog or Digital Run Crank Input(Low/High) Determination.
      boolean SUSD_C_RunCrankInputType: set at pre-compile, origin=GM_ECUC, default-value=true  # This calibration is used to determine the Run Crank Input Type(DISCRETE/ANALOG),default DISCRETE
      container SUSD_C_SWCInfo [0..*]  # This container contains the Configuration Parameters for Calibration Prameters of SUM SUSD
        string SUSD_SWCName: origin=GM_ECUC  # String to indicate the SWC name for interface to map the ports in SWC-D
        boolean SUSD_C_ShutdownPermControl: set at pre-compile, origin=GM_ECUC, default-value=1  # A boolean calibration parameter for each shutdown permission interface to control the processing of its permissions
        reference SUSD_BatteryVoltageRangeRef [0..1]: set at pre-compile in variant pre-compile / post-build in variant post-build, origin=GM_ECUC, destination=SUSD_C_BatteryVoltageRange  # Reference to a battery voltage range"
        reference SUSD_SWCs_SpecificWkSrcId [0..*]: set at pre-compile, destination=EcuMWakeupSource  # This parameter defines the identifier of this wakeup source.
      container SUSD_C_SUMsInfo [1..*]  # This container contains the Configuration Parameters for Calibration Prameters of SUM SUSD
        enumeration SUSD_SUMsName: set at pre-compile in variant pre-compile / post-build in variant post-build, symbolic-name-value=NOT_Applicable  # This parameter defines the type of SUM component that SUSD will interface with, such as SUM_SPM, SUM_LNM, SUM_SSFM-SSM, SUM_SSFM-ERRH, SUM_SSC, SUM_PNC, SUM_DIAG, SUM_TCS, SUM_SRVMGR, or SUM_SOH.
          SUM_SPM  # NOT_Applicable
          SUM_LNM  # With_OBD
          SUM_SSFM_ERRH  # With_Cybersecurity
          SUM_SSFM_SSM  # With_Cybersecurity
          SUM_SSC  # Without_Cybersecurity
          SUM_PNC
          SUM_DIAG  # Diagnostics Manager
          SUM_TCS
          SUM_SRVMGR  # Service Manager
          SUM_SOH  # State of Health Manager
        boolean SUSD_PermitExecution: set at pre-compile, origin=GM_ECUC, default-value=true  # Enables or disables the Permit Execution Interface to PNC SUM
        boolean SUSD_ShutdownPermission: set at pre-compile, origin=GM_ECUC, default-value=true  # Enables or disables the Permit Execution Interface to LNM SUM
        reference SUSD_SUMs_SpecificWkSrcId [0..*]: set at pre-compile, destination=EcuMWakeupSource  # This parameter defines the identifier of this wakeup source.
      container SUSDDiagReferences  # Diagnostic Service References.
        reference SusdEcuWakeupDetectionRecordsDidRef: set at pre-compile in variant pre-compile / post-build in variant post-build, destination=DcmDspDid  # Reference to DID 0xF09E "ECU Wakeup Detection Records"
        reference SusdRid41ARef: set at pre-compile, destination=DcmDspRoutine  # Reference to RID 0x41A "Clear ECU Wakeup Detection Records"
        reference Did_E0D7_Reference: set at pre-compile in variant pre-compile / post-build in variant post-build, destination=DcmDspDid  # Reference to DID 0xE0D7 "Wakeup and Off Power Mode Activity Records"
        reference Did_F088_Reference: set at pre-compile in variant pre-compile / post-build in variant post-build, destination=DcmDspDid  # Reference to DID 0xF088 "Control Module Input Voltage"
        reference Did_F089_Reference: set at pre-compile in variant pre-compile / post-build in variant post-build, destination=DcmDspDid  # Reference to DID 0xF089 Application Shutdown Prohibit, that contains the current internal value of the permission for the ECU to shutdown.
      container SUSD_BatteryVoltageRange
        float SUSD_DefaultUnderVoltage_hysteresis: 0..0.5, set at pre-compile, origin=GM_ECUC, default-value=0  # The hysteresis for under default voltage range in volts and only used with default voltage range 9V - 16V
        float SUSD_DefaultOverVoltage_hysteresis: 0..0.5, set at pre-compile, origin=GM_ECUC, default-value=0  # The hysteresis for the over voltage range in volts and only used with default voltage range 9V - 16V
        container SUSD_C_BatteryVoltageRange [0..*]
          float SUSD_C_BatteryVoltageRange_Min: 3..28.5, set at pre-compile, origin=GM_ECUC, default-value=9  # The minimum voltage range in volts
          float SUSD_C_BatteryVoltageRange_Max: 3..28.5, set at pre-compile, origin=GM_ECUC, default-value=16  # The maximum voltage range in volts
          float SUSD_C_UnderVoltage_hysteresis: 0..0.5, set at pre-compile, origin=GM_ECUC, default-value=0  # The hysteresis for the under voltage range in volts
          float SUSD_C_OverVoltage_hysteresis: 0..0.5, set at pre-compile, origin=GM_ECUC, default-value=0  # The hysteresis for the over voltage range in volts
      container Sum_SUSD_ActivityRecords [0..1]  # This container contains the Configuration Parameters for Activity Record feature of SUM_SUSD
        float Sum_SUSD_AR_Periodicity: set at post-compile in variant pre-compile / post-build in variant post-build, default-value=1.0  # The periodicity of Activity Record periodic handler in ms.
        integer Sum_SUSD_k_AR_Active_Delay: 0..255, set at post-compile in variant pre-compile / post-build in variant post-build, default-value=120  # The default value of calibration parameter k_AR_Active_Delay in seconds.
        integer Sum_SUSD_k_AR_Init_Delay: 0..2550, set at post-compile in variant pre-compile / post-build in variant post-build, default-value=500  # The default value of calibration parameter k_AR_Init_Delay in ms.
        enumeration Sum_SUSD_Record0x01_Type: {Enumerated, BitMapped}, set at pre-compile in variant pre-compile / post-build in variant post-build, default-value=Enumerated  # Indicator of record 0x01 store type.
        reference Sum_SUSD_E0D7NvMBlockRef: set at pre-compile, destination=NvMBlockDescriptor  # Reference to NvM Block Descriptor of DID E0D7 Data
        reference Sum_SUSD_FirstBootPostFlashNvMBlockRef: set at pre-compile, destination=NvMBlockDescriptor  # Reference to NvM Block Descriptor of First Boot Post-Flash Flag
        reference Sum_SUSD_E0D7_MonitorDisabled_NvMBlockRef: set at pre-compile, destination=NvMBlockDescriptor  # Reference to NvM Block Descriptor of DID 0xE0D7 Monitor Disabled flag
        reference Sum_SUSD_LIN_WakeupSource [0..*]: set at pre-compile, destination=EcuMWakeupSource  # List of the LIN WakeUpSources in EcuM.
        reference Sum_SUSD_ECU_WakeupSource [0..*]: set at pre-compile, destination=EcuMWakeupSource  # List of the Record 0x01 WakeUpSources in EcuM.
    container SUSDGeneral  # General configuration parameters of the SUSD.
      float SUSD_t_Shutdown_Refresh: 0.001..0.5, set at pre-compile, origin=GM_ECUC, default-value=0.1  # Time in sec, for which a SW-C with a ShutdownPermission interface, shall refresh its signal for that interface
      float SUSD_t_Force_Shutdown_Wait: 0..65.535, set at pre-compile, origin=GM_ECUC, default-value=0  # Time in sec(greater than zero), for which SUSD shall wait before requesting Shutdown from BswM, after indicating to all SW-Cs with PermitExecution interface to Shutdown.
      integer SUSD_t_Battery_Periodicity: 1..500, set at pre-compile, origin=GM_ECUC, default-value=100  # Time in msec, for the periodicity of notifying SW-C of changes to the Battery Monitors.
      integer SUSD_t_VehiclePowerMode_Periodicity: 1..500, set at pre-compile, origin=GM_ECUC, default-value=100  # Time in msec, for the periodicity of notifying SW-C of changes to the Vehicle Power Mode.
      float SUSD_t_ResetExecution_Periodicity: 1.0..65.535, set at pre-compile, origin=GM_ECUC, default-value=1.0  # Time in msec, for the periodicity of Reset Execution and Running Reset Timer.
      integer SUM_SUSD_RESETExecution_TIMER_Thresh_Init: 0..10, set at pre-compile, origin=GM_ECUC, default-value=10  # Initial value of the Calibration parameter SUM_SUSD_RESETExecution_TIMER_Thresh.
      integer SUSD_t_RunCrank_Periodicity: 1..500, set at pre-compile, origin=GM_ECUC, default-value=100  # Time in msec, for the periodicity of notifying SW-C of changes to the Run Crank.
      integer SUSD_t_Wakeup_Periodicity: 1..500, set at pre-compile, origin=GM_ECUC, default-value=100  # Time in msec, for the periodicity of Wake up polling.
      integer SUSD_t_AppManager_Periodicity: 1..500, set at pre-compile, origin=GM_ECUC, default-value=100  # Time in msec, for the periodicity of AppStateManager.
      float SusdInitFuncPeriodicity [0..1]: 1.0..5000.0, default-value=1000.0  # Period in milliseconds that configures the runnable init function periodicity. This parameter is required when SusdGenerateInitRunnable is set to TRUE.
      boolean SusdGenerateInitRunnable: default-value=False  # The parameter shall generate SUSD init runnable if it is configured as TRUE. Otherwise the SUSD_Init() function shall be called by a BswM action list during startup
      integer SUSD_C_RunningResetWaitTime [0..1]: 0..65535, set at pre-compile, origin=GM_ECUC, default-value=625  # Time in msec, for the serial data wait time after running reset occurs before going Fail-Soft state.
      boolean SUSD_Battery_State_of_Charge_Supported: set at pre-compile, origin=GM_ECUC, default-value=false  # True if the ECU has an input which monitors the vehicle battery state of charge.
      boolean SUSD_PowerModing_Slave_Supported: set at pre-compile, origin=GM_ECUC, default-value=false  # true if the ECU is not the Power Mode Master,false if the ECU is the Power Mode Master.true: Enabled false: Disabled.
      boolean SUSD_RunCrankPlausibility_Supported: set at pre-compile, origin=GM_ECUC, default-value=false  # true if the RunCrank Input is available from one of the software component,false if the RunCrank Input is not available from any of the software component.true: Enabled false: Disabled.
      enumeration SUSD_C_DefaultShutdownState: {Off, Sleep}, set at pre-compile, origin=GM_ECUC  # The default ECU operation state when shutting down: {Off or Sleep}.
      boolean SUSD_VPM_ASIL_A_Supported [0..1]: set at pre-compile, origin=GM_ECUC  # This parameter shall control the determination of Vehicle Power Mode at ASIL A or QM level. If set to False, then VPM shall be calculated without Failed Safety signals.
      enumeration SUSD_VPM_Security_Supported [0..1]: {NOT_Applicable, With_OBD, With_Cybersecurity, Without_Cybersecurity}, set at pre-compile in variant pre-compile / post-build in variant post-build, origin=ETAS:1.1.0:2015-07-15, symbolic-name-value=NOT_Applicable  # This parameter shall control the determination of Vehicle Power Mode with or without Cybersecurity. If set to False, then VPM shall be calculated without Failed Security signals.
      enumeration SUSD_VPM_SPM_Initial: {SUM_PMS_OFF, SUM_PMS_ACCESSORY, SUM_PMS_RUN, SUM_PMS_STARTREQUEST, SUM_PMS_PROPULSION, SUM_PMS_TRANSPORT}, set at pre-compile in variant pre-compile / post-build in variant post-build, origin=RB:0.1.0:2015-12-05, default-value=SUM_PMS_OFF  # Initial value for System Power Mode used for Vehicle Power Mode determination when a valid System Power Mode has not been received yet.
      enumeration SUSD_VPM_SBPM_Initial: {SUM_PMS_OFF, SUM_PMS_ACCESSORY, SUM_PMS_RUN, SUM_PMS_STARTREQUEST, SUM_PMS_PROPULSION, SUM_PMS_TRANSPORT}, set at pre-compile in variant pre-compile / post-build in variant post-build, origin=RB:0.1.0:2015-12-05, default-value=SUM_PMS_OFF  # Initial value for System Backup Power Mode used for Vehicle Power Mode determination when a valid System Backup Power Mode has not been received yet.
      boolean SUSD_PermitExecAvailable: set at pre-compile, origin=GM_ECUC, default-value=true  # A parameter for Permit Execution Interface for this SWC
      boolean SUSD_DisNvMWriteAvailable [0..1]: set at pre-compile, origin=GM_ECUC, default-value=true  # A parameter for Disable NvM Write Interface for this SWC
      boolean SUSD_ECUOpStateDIDSupported: set at pre-compile, origin=GM_ECUC, symbolic-name-value=true, default-value=1  # This parameter created to provide user the option to choose ECU Operating State DID as optional
      reference SUSD_BatteryVoltageDIDSigRef [0..1]: set at pre-compile in variant pre-compile / post-build in variant post-build, origin=ETAS:1.1.0:2015-07-15, destination=DcmDspDid  # Reference to DID for Battery Voltage Signal
      choice reference SUSD_WakeupSourceReasonDIDSigRef [0..1]: set at pre-compile in variant pre-compile / post-build in variant post-build, origin=ETAS:1.1.0:2015-07-15, destination=DcmDspDid  # Reference to DID for Wakeup Source Reason Signal.
      choice reference SUSD_ActiveWakeupSourceDIDSigRef [0..1]: set at pre-compile in variant pre-compile / post-build in variant post-build, origin=ETAS:1.1.0:2015-07-15, destination=DcmDspDid  # Reference to DID for Active Wakeup Source(s) Signal.
      choice reference SUSD_ECUOperatingStateDIDSigRef [0..1]: set at pre-compile in variant pre-compile / post-build in variant post-build, origin=ETAS:1.1.0:2015-07-15, destination=DcmDspDid  # Reference to DID for ECU Operating State Signal.
      choice reference SUSD_PowerModingStateDIDSigRef [0..1]: set at pre-compile in variant pre-compile / post-build in variant post-build, origin=ETAS:1.1.0:2015-07-15, destination=DcmDspDid  # Reference to DID for Power Moding State Signal.
      choice reference SUSD_VehiclePowerModeInvalidityDIDSigRef [0..1]: set at pre-compile in variant pre-compile / post-build in variant post-build, origin=ETAS:1.1.0:2015-07-15, destination=DcmDspDid  # Reference to DID for Vehicle Power Mode Invalidity Signal.
      choice reference SUSD_DemDataElementClass_VPwrSetEnCondDataSigRef [0..1]: set at pre-compile in variant pre-compile / post-build in variant post-build, origin=ETAS:1.1.0:2015-07-15, destination=DemDataElementClass  # Reference to Dem Data Element Class for Vehicle Power Set Enable Condition Data Signal.
      reference SusdEcuWakeUpDetectionRecordsNvmBlockRef: set at pre-compile in variant pre-compile / post-build in variant post-build, origin=ETAS:1.1.0:2015-07-15, destination=NvMBlockDescriptor  # Reference to NVM Block for storing ECU Wakeup Detection Records
      reference SUM_SUSD_RESETExecution_TIMERNvmBlockRef: set at pre-compile in variant pre-compile / post-build in variant post-build, origin=ETAS:1.1.0:2021-05-19, destination=NvMBlockDescriptor  # Reference to NVM Block for storing SUM_SUSD_RESETExecution_TIMER
      foreign reference Sum_SUSD_ServiceBased_DataTypeMappingSet [0..*]: destination-type=DATA-TYPE-MAPPING-SET  # Foreign reference to the DATA-TYPE-MAPPING-SET in the system extract used for service-based operations. This parameter references the system data type mapping sets that define the structure and format for PMM and BPMM service-based functionality and data transformations.
      choice reference Sum_SUSD_Sig_PrimaryPowerMode_Ref: set at pre-compile, destination=[ComGroupSignal, ComSignal]  # Foreign reference to the Com Signal for Primary Power Mode. This signal can be configured as a single signal or as a signal belonging to a group of signals.
      foreign reference Sum_SUSD_ServiceBased_PMM_Ref [0..1]: set at pre-compile, origin=RB, destination-type=IMPLEMENTATION-DATA-TYPE-ELEMENT  # Foreign reference to the IMPLEMENTATION-DATA-TYPE for Service-Based Primary Power Mode from System Extract from Software-AR-Packages
      choice reference Sum_SUSD_Sig_BackupPowerMode_Ref: set at pre-compile, destination=[ComGroupSignal, ComSignal]  # Foreign reference to the Com Signal for Backup Power Mode. This signal can be configured as a single signal or as a signal belonging to a group of signals.
      foreign reference Sum_SUSD_ServiceBased_BPMM_Ref [0..1]: set at pre-compile, origin=RB, destination-type=IMPLEMENTATION-DATA-TYPE-ELEMENT  # Foreign reference to the IMPLEMENTATION-DATA-TYPE for Service-Based Backup Power Mode from System Extract from Software-AR-Packages
    container SUSDWakeUpRelation  # This container contains a list of Wakeup Source identifiers that are needed to refer to indicate the Permit Execution to SUMs.
      reference SUSD_WakeupSourceId [1..*]: set at pre-compile, destination=EcuMWakeupSource  # This parameter defines the identifier of this wakeup source.
