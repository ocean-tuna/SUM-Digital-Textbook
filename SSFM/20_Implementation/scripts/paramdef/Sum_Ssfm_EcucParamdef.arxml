AUTOSAR XML (schema 00049)
# COPYRIGHT RESERVED, 2020 ETAS GmbH. All rights reserved.
# The reproduction, distribution and utilization of this document as well as
# the communication of its contents to others without explicit authorization
# is prohibited. Offenders will be held liable for the payment of damages.
# All rights reserved in the event of the grant of a patent, utility model or
# design.
package /AUTOSAR_SSFM/EcucModuleDefs
  module definition SSFM [0..1]: refined-module-def=SSFM, variants post-build  # Configuration of the SSFM module.
    container Sum_Ssfm_General  # General configuration parameters of the SSFM.
      integer Sum_Ssfm_SsmPermitExecutionMask: 0..255, set at pre-compile in variant pre-compile / post-build in variant post-build, origin=ETAS:1.0.0:2015-05-04, default-value=254  # PermitExecution mask to start execution of the SSM sub-module.
      integer Sum_Ssfm_ErrhPermitExecutionMask: 0..255, set at pre-compile in variant pre-compile / post-build in variant post-build, origin=ETAS:1.0.0:2015-05-04, default-value=254  # PermitExecution mask to start execution of the Errh sub-module.
      float Sum_Ssfm_ExecutionManagerPeriodicity: 1..65535, set at pre-compile in variant pre-compile / post-build in variant post-build, origin=ETAS:1.0.0:2015-05-04, default-value=100  # SsfmMainFunctionPeriod | Period (ms) of the Main Function Runnables. Handling internal modes and shutdown procedure.
      float Sum_Ssfm_DTCTriggeredRunnablePeriodicity [0..1]: 1..65535, set at pre-compile in variant pre-compile / post-build in variant post-build, origin=ETAS:1.0.0:2015-05-04, default-value=100  # SsfmDTCTriggeredFunctionPeriod | The period (milliseconds) of the Sum_Ssfm_DTCTriggeredMessageHandler Runnables handles notify other ECUs or Test Devices that a fault has been detected .
      float Sum_Ssfm_KeySlotVerify_RunnablePeriodicity [0..1]: 1.0..65535.0, set at pre-compile in variant pre-compile / post-build in variant post-build, origin=ETAS:1.0.0:2015-05-04, default-value=1.0  # The period (milliseconds) of the KeySlotVerifyErrors_Time_Management Runnable handles KeySlot verification errors.
      float Sum_Ssfm_NodeLossError_RunnablePeriodicity [0..1]: 1.0..65535.0, set at pre-compile in variant pre-compile / post-build in variant post-build, origin=ETAS:1.0.0:2015-05-04, default-value=1.0  # The period (milliseconds) of the SSFM_NodeLossError_Time_Management Runnable handles NodeLoss errors.
      float Sum_Ssfm_MissingMsg_Periodicity [0..1]: 1..65535, set at pre-compile in variant pre-compile / post-build in variant post-build, default-value=100  # SsfmMissingMsgFunctionPeriod | Period (ms) of the Lin Responder Missing Message Runnables. Handling internal logic to check for test enable condition for missing message error.
      integer Sum_Ssfm_MissingMsg_CalibratableTime [0..1]: 1..65535, set at pre-compile in variant pre-compile / post-build in variant post-build, default-value=5  # SsfmMissingMsgCalibrateTime | The period timer in seconds of the Sum_Ssfm_MissingMsg_CalibrateTime handles the test enable for Lin Responder missing message error type .
      boolean Sum_Ssfm_FxI_FxFA_SinglePortsSupport: set at pre-compile, default-value=false  # Setting this parameter to True provides the support for the single port indication of FxI/FxFA
      boolean Sum_Ssfm_IsThisECUGateway: set at pre-compile, default-value=false  # Setting this parameter to True indicates that the current ECU will act as a gateway
      boolean Sum_Ssfm_DtcTriggerMessageSupport: set at pre-compile, default-value=true  # Enables/Disables the DTCTrigger Message function
      integer Sum_Ssfm_DTCNotificationQueueSize [0..1]: 0..32767, set at pre-compile in variant pre-compile / post-build in variant post-build, origin=ETAS:1.0.0:2015-05-04, default-value=32  # When Sum_Ssfm_DtcTriggerMessageSupport is enabled, this parameter shall be configured. Size of the DTC queue used for the DTC_Triggered signal. The final queue size will be equal to this parameter value plus the 22 reserved cells for DTC U007x information.
      boolean SsfmGenerateInitRunnable: set at pre-compile in variant pre-compile / post-build in variant post-build, origin=RB:0.1.0:2015-12-05, default-value=false  # Configuration parameter SsfmGenerateInitRunnable is used to allow the generation of a periodic runnable to run function Runnable_SSFM_Init one time. If TRUE the SSFM module should generate the periodic runnable to execute init() function one time otherwise, the init() function is called by a BswM action list during startup.
      float SsfmInitFuncPeriodicity [0..1]: 1.0..5000.0, set at pre-compile in variant pre-compile / post-build in variant post-build, origin=ETAS:1.0.0:2015-05-04, default-value=1000.0  # Specifies time in milisecond, for the periodicity of the runnable RE_SSFM_Init. Float values are supported. This parameter is required when SsfmGenerateInitRunnable is set to TRUE
      boolean SSFM_QoS_Enabled: default-value=true  # Enable consolidated QoS indication interfaces. If disabled, no QoS-related ports or code will be generated.
      reference Sum_Ssfm_Os_Counter_1ms_Ref: destination=OsCounter  # Reference to the SSFM specific 1ms Os Counter.
      reference Sum_Ssfm_ComMPNCRef [0..*]: set at pre-compile, destination=ComMPnc  # Configure all references to PNC that the ECU participates in that are enabled for TX. The references must be configured when the Sum_Ssfm_DtcTriggerMessageSupport parameter is enabled.
      foreign reference Sum_Ssfm_QoS_DataTypeMappingSet [0..1]: destination-type=DATA-TYPE-MAPPING-SET  # Foreign reference to the DATA-TYPE-MAPPING-SET in the system extract used for QoS operations. This parameter is used to resolve the implementation data type for the QoS interface.
    container Sum_Ssfm_Channel [0..*]  # This container contains the list of Channels used by the SUM_SSFM module.
      boolean Sum_Ssfm_Ssm_C_UsageOfCanBusOffDTC: set at pre-compile  # Calibration parameter indicates usage of CAN BUS OFF DTC. When it is set to true Loss of Com indications will be set based on CAN BUS OFF DTC.
      reference Sum_Ssfm_Channel_ID_Ref [0..1]: destination=ComMChannel  # Reference to the ComM Channel which will be used to detect the Disable Normal Comm request from SUM_DIAG.
    container Sum_Ssfm_ConfigSet  # SSFMConfigSet subcontainer.
      container Sum_Ssfm_C_SsmDisable_Tx_PDU [0..*]  # This sub container contains the information for controlling whether to process this Pdu or not
        boolean Sum_Ssfm_Ssm_C_DisablePDU: set at pre-compile, default-value=false  # Calibration parameter disable PDU. When it is set to True the PDU will be disabled. Instead, the False will keep the PDU Enabled.
        reference Sum_Ssfm_C_SsmDisable_Tx_PDURef: destination=ComIPdu  # Reference to Com Ipdu. This is used for calibration of disabling the PDUs for transmit where SSM requests BswM during Init to disable the PDU
      container Sum_Ssfm_SerialData [1..*]  # It contains the parameters related to the Ethernet/CAN SerialData.
        boolean Sum_Ssfm_IsNonDiscoverable [0..1]: set at pre-compile in variant pre-compile / post-build in variant post-build, origin=ETAS:8.0.1:2025-01-15, default-value=false  # Identifies if this SerialData represents a non-discoverable SOME/IP service (signal-based PDU using SOME/IP transformer). Non-discoverable services are always available, bypass partial network conditions, and only report Security and Safety diagnostics.
        reference Sum_Ssfm_RteSerialData_Ref: destination=RteSerialData  # Reference to the RteSerialData
        reference Sum_Ssfm_SecOCRxPdu_Ref [0..1]: destination=SecOCRxPduProcessing  # Reference to the SecOC RxPdu
        reference Sum_Ssfm_Channel_Ref [0..1]: destination=Sum_Ssfm_Channel  # Reference to Sum_Ssfm_Channel
        reference Sum_Ssfm_Partial_Network_Ref [0..*]: destination=ComMPnc  # Reference to the Partial Network
        choice reference Sum_Ssfm_SDService_Ref [0..1]: destination=[SdClientService, SdServerService]  # Reference to the SD Client or Server Service instance to which this SerialData belongs. This should be added when the SerialData is dedicated to the SD traffic.
        reference Sum_Ssfm_C_SsmDisable_Rx_PDURef [0..1]: destination=ComIPdu  # Reference to Com Ipdu to which the CAN SerialData belongs to. This is used for checking if the calibration of disabling the PDUs for SerialDatas is enabled. Based on the calibration value for this PDU, SerialData status shall be monitored
        choice reference Sum_Ssfm_MessageID_Ref [0..1]: destination=[CanIfRxPduCfg, SoAdSocketRoute]  # Reference to either SoAdSocketRoute or CanIfRxPduCfg to indicate the message id.
        foreign reference Sum_Ssfm_QoS_Ref [0..*]: set at pre-compile, origin=RB, destination-type=IMPLEMENTATION-DATA-TYPE-ELEMENT  # Reference to the signal or service event member containing this payload.
        container Sum_Ssfm_FcI_Debouncer [0..1]  # This sub container contains the information for the debouncing of FcI
          reference Sum_Ssfm_EventFilter_Ref: destination=Sum_Ssfm_Errh_GeneralEventsFilter  # Reference to the General Event Filter.
        container Sum_Ssfm_FoI_Debouncer [0..1]  # This sub container contains the information for the debouncing of FoI
          reference Sum_Ssfm_EventFilter_Ref: destination=Sum_Ssfm_Errh_GeneralEventsFilter  # Reference to the General Event Filter.
        container Sum_Ssfm_FpI_Debouncer [0..1]  # This sub container contains the information for the debouncing of FpI
          reference Sum_Ssfm_EventFilter_Ref: destination=Sum_Ssfm_Errh_GeneralEventsFilter  # Reference to the General Event Filter.
        container Sum_Ssfm_FsI_Debouncer [0..1]  # This sub container contains the information for the debouncing of FsI
          reference Sum_Ssfm_EventFilter_Ref: destination=Sum_Ssfm_Errh_GeneralEventsFilter  # Reference to the General Event Filter.
      container RteSerialData [0..*]: destination-uri=RteSerialData, origin=ETAS  # Configuration of an individual serial data corresponding to a protected signal/signalGroup.
        boolean RteSerialDataE2EInTransformerChain [0..1]: origin=ETAS, set at pre-compile, default-value=false  # If the E2E transformer is configured, this parameter must be set to True, otherwise to False. If True, the Rte will pass the transformerError to the RteSerialData.RteCallBackFunction.
        string RteSerialDataHeaderInclude: multiplicity set at pre-compile, origin=ETAS, set at pre-compile  # Defines the header file where the serial data provides the function declarations for configured callbacks.
        function name RteCallBackFunction: multiplicity set at post-build in variant post-build / pre-compile in variant pre-compile, origin=ETAS, post-build-variant-multiplicity=true, post-build-variant-value=true, set at post-build in variant post-build / pre-compile in variant pre-compile, default-value="NULL"  # Definition of the Callback function provided by module which is interested in the serial data.
        container RteSignal  # Reference to the signal in the system description.
          choice container RteSignalChoice  # Choice whether an ISignal or an ISignalGroup shall be referenced.
            container RteISignalRefChoice [0..1]  # Reference to the ISignal in the system description.
              foreign reference RteISignalRef: origin=ETAS, set at pre-compile, destination-type=I-SIGNAL  # Reference to the ISignal in the system description.
            container RteISignalGroupRefChoice [0..1]  # Reference to the ISignalGroup in the system description.
              foreign reference RteISignalGroupRef: origin=ETAS, set at pre-compile, destination-type=I-SIGNAL-GROUP  # Reference to the ISignalGroup in the system description.
      container Sum_Ssfm_GroupInfo [0..1]  # It contains group of the parameters related to the Ethernet/CAN serialData(s) ECUs and LIN serialData(s).
        reference Sum_Ssfm_DemDataElementClass_XXXX87_Ref [0..1]: destination=DemDataElementClass  # Reference to the Dem Data Element Class associated to the Freeze Frame of the DTC UXXXX_87.
        container Sum_Ssfm_ECUInfo [0..*]  # It contains the parameters related to the ECUs
          boolean Sum_Ssfm_Errh_C_DTCProcess_SsmNodeLoss: set at pre-compile, origin=GM_ECUC, default-value=true  # Boolean flag for controlling whether to process DTC for Ssm Node Loss Error
          integer Sum_Ssfm_LossCommID [0..1]: 0..255, set at pre-compile in variant pre-compile / post-build in variant post-build  # The ECU ID for the Loss of Communication functionality
          integer Sum_Ssfm_LC_ECU_Timer_Ref: 0..12000, set at pre-compile in variant pre-compile / post-build in variant post-build, default-value=0  # Time in msec, for reference ECU Node Lost Communication debounce timer.
          boolean Sum_Ssfm_IsGateway: set at pre-compile, default-value=false  # This parameter indicates if the ECU will act as a gateway or not.
          container Sum_Ssfm_ECUInfo_SerialData [0..*]  # This sub container contains the information for SerialDatas belong to an ECU
            enumeration Sum_Ssfm_FaultDetectionUsage: {None, FaultAndRecovery, RecoveryOnly}, default-value=None  # Indicates if the SerialData will be used for Lost Communication fault and recovery detection, or only recovery detection, or neither of them.
            enumeration Sum_Ssfm_RoutingMethod: {Direct, PDURouted, SignalRouted}  # Describes the routing method of the SerialData to the receiver ECU.
            choice reference Sum_Ssfm_SerialData_Ref: destination=Sum_Ssfm_SerialData  # Reference to the SerialData
          container Sum_Ssfm_ECUInfo_Event [0..*]  # This sub container contains mappings between channels of serial datas and Dem events for LossOfCommunication and signaling invalid data on the same serial datas.
            reference Sum_Ssfm_Channel_Ref: destination=Sum_Ssfm_Channel  # Reference to a channel used by one or more SerialData
            reference Sum_Ssfm_LossOfComm_DemEvent_Ref: destination=DemEventParameter  # Reference to the Dem LossOfCommunication event for the referenced SerialData channel .
            reference Sum_Ssfm_InvalidData_DemEvent_Ref [0..1]: destination=DemEventParameter  # Reference to the Dem InvalidData event for the referenced SerialData channel .
        container Sum_Ssfm_TrgDvcInfo [0..*]  # It contains the parameters related to a Service Based Target Device
          boolean Sum_Ssfm_Errh_C_DTCProcess_TrgDvc_SsmNodeLoss: set at pre-compile, origin=GM_ECUC, default-value=true  # Boolean flag for controlling whether to process DTC for Ssm Node Loss Error
          integer Sum_Ssfm_LF_TrgDvc_Timer: 0..12000, set at pre-compile in variant pre-compile / post-build in variant post-build, default-value=0  # Time in msec, for TrgDvc Loss of Function (LoF) debounce timer.
          reference Sum_Ssfm_SpmTargetDevice_Ref [0..1]: destination=SpmTrgDvc  # Reference to the SPM target device.
        container Sum_Ssfm_LINInfo [0..*]  # It contains the reference parameters related to LIN serialData(s)
          boolean Sum_Ssfm_LINResponderOBD_Supported: set at pre-compile in variant pre-compile / post-build in variant post-build, default-value=false  # Boolean flag for defining if OBD is supported by LIN Responder
          reference Sum_Ssfm_LNM_ResponderInfo_Ref: destination=LNM_Responders  # Reference to the LIN Responder of a LIN network.
          reference Sum_Ssfm_Channel_Ref: destination=Sum_Ssfm_Channel  # Reference to a LIN channel of a LIN Responder
          container Sum_Ssfm_LINInfo_SerialData [0..*]  # This sub container contains the information for SerialDatas belong to a LIN Responder
            choice reference Sum_Ssfm_SerialData_Ref: destination=Sum_Ssfm_SerialData  # Reference to the LIN SerialData
          container Sum_Ssfm_LINInfo_Event [0..1]  # This sub container contains Dem event for Internal Electronic Fault and signaling invalid data of a LIN Responder.
            reference Sum_Ssfm_IeF_DemEvent_Ref [0..1]: destination=DemEventParameter  # Reference to the Dem event that should keep track of the Internal Electronic Fault Error Code for the referenced LIN Responder.
            reference Sum_Ssfm_MissingMsg_DemEvent_Ref [0..1]: destination=DemEventParameter  # Reference to the Dem event that should keep track of the Missing Message Error Code for the referenced LIN Responder.
            reference Sum_Ssfm_InvalidData_DemEvent_Ref [0..1]: destination=DemEventParameter  # Reference to the Dem event that should keep track of invalid data event for the referenced LIN SerialData channel.
      container Sum_Ssfm_ErrorsHandlers [0..1]  # List of all configured errors that are handled by Errh submodule of SSFM.
        container Sum_Ssfm_Errh_BswError [0..*]  # List all configured BSW events that shall be debounced by Errh as possible errors.
          boolean Sum_Ssfm_Errh_C_BswDTCProcess: set at pre-compile, origin=GM_ECUC, default-value=true  # Boolean flag for controlling whether to process DTC
          enumeration Sum_Ssfm_BswEventType [0..1]: {NVM_E_HARDWARE, NVM_E_INTEGRITY_FAILED, NVM_E_REQ_FAILED, NVM_E_WRONG_BLOCK_ID, NVM_E_VERIFY_FAILED, NVM_E_LOSS_OF_REDUNDANCY, NVM_E_QUEUE_OVERFLOW, NVM_E_WRITE_PROTECTED, WDGM_E_SUPERVISION, WDGM_E_SET_MODE}  # Describes BswEvent/bitmap which are routed from SSFM-ERRH to the SUM_SOH for processing. Bit 0 == NVM_E_HARDWARE, Bit 1 == NVM_E_INTEGRITY_FAILED, Bit 2 == NVM_E_REQ_FAILED, Bit 3 == NVM_E_WRONG_BLOCK_ID, Bit 4 == NVM_E_VERIFY_FAILED, Bit 5== NVM_E_LOSS_OF_REDUNDANCY, Bit 6 == NVM_E_QUEUE_OVERFLOW, Bit 7 == NVM_E_WRITE_PROTECTED, Bit 8 == WDGM_E_SUPERVISION, Bit 9 == WDGM_E_SET_MODE, Bit 10 till Bit 31== Reserved.
          reference Sum_Ssfm_Errh_BSWErr_EventFilter_Ref: destination=Sum_Ssfm_Errh_GeneralEventsFilter  # Reference to the SSFM associated error filter.
          reference Sum_Ssfm_EventIdToUpdateError_ref: set at pre-compile in variant pre-compile / post-build in variant post-build, destination=DemEventParameter  # Reference to the associated DEM event for filtering.(I/P)
          reference Sum_Ssfm_EventIdForSettingDTC_ref [0..1]: set at pre-compile in variant pre-compile / post-build in variant post-build, destination=DemEventParameter  # Reference for the associated DEM event that sets the DTC for this relevant error(O/P).
          reference Sum_Ssfm_Channel_Ref [0..1]: destination=Sum_Ssfm_Channel  # Reference to Sum_Ssfm_Channel, Needed to publish Bus off errors
        container Sum_Ssfm_Errh_LNMErrors [0..1]  # List all configured LNM events that shall be debounced by Errh as possible errors.
          container Sum_Ssfm_LNM_ResponderInfoError [0..*]  # List of all LNM reported errors of Network Responder(s) information type
            enumeration Sum_Ssfm_LNM_ResponderInfoErrorType: {SSFM_LNM_RESPONDER_IEF, SSFM_LNM_RESPONDER_MISSING_MSG, SSFM_LNM_RESPONDER_MISSING_CAL, SSFM_LNM_RESPONDER_NOT_CONFIGURED}  # Enumerative value to specify the type of LNM Network Responder Information Error Type: - SSFM_LNM_RESPONDER_IEF = Internal Electronic Fault; - SSFM_LNM_RESPONDER_MISSING_MSG = Missing Message Error; - SSFM_LNM_RESPONDER_MISSING_CAL = Missing Calibration Error; - SSFM_LNM_RESPONDER_NOT_CONFIGURED = Not Configured Sensor;
            reference Sum_Ssfm_LNMResponderErr_EventFilter_Ref [0..1]: destination=Sum_Ssfm_Errh_GeneralEventsFilter  # Reference to Sum_Ssfm_Errh_GeneralEventsFilter.
            reference Sum_Ssfm_LINInfo_Ref: destination=Sum_Ssfm_LINInfo  # Reference to the Sum_Ssfm_LINInfo associated to LIN Responder
        container Sum_Ssfm_Errh_SUSDErrors [0..1]  # List all configured SUSD events that shall be debounced by Errh as possible errors.
          container Sum_Ssfm_Errh_SUSD_RunCrankHIGH_DiagStatus [0..1]  # Diagnostic status error for Run Crank stuck-at HIGH level.
            boolean Sum_Ssfm_Errh_C_DTCProcess_RCHigh: set at pre-compile, origin=GM_ECUC, default-value=true  # Boolean flag for controlling whether to process DTC for Run Crank High Diagnostic Status
            reference Sum_Ssfm_Errh_SUSD_RCHigh_EventFilter_Ref: destination=Sum_Ssfm_Errh_GeneralEventsFilter  # Reference to Sum_Ssfm_FilterType which is the filter type of SUSD error event for Run Crank Input Stuck High Diagnostic Status.
            reference Sum_Ssfm_GetDTCStatus_DemEvent_Ref: destination=DemEventParameter  # Reference to the Dem event for the for Run Crank High Diagnostic Status
          container Sum_Ssfm_Errh_SUSD_RunCrankLOW_DiagStatus [0..1]  # Diagnostic status error for Run Crank stuck-at LOW level
            boolean Sum_Ssfm_Errh_C_DTCProcess_RCLow: set at pre-compile, origin=GM_ECUC, default-value=true  # Boolean flag for controlling whether to process DTC Run Crank Low Diagnostic Status
            reference Sum_Ssfm_Errh_SUSD_RCLow_EventFilter_Ref: destination=Sum_Ssfm_Errh_GeneralEventsFilter  # Reference to Sum_Ssfm_FilterType which is the filter type of SUSD error event for Run Crank Input Stuck Low Diagnostic Status.
            reference Sum_Ssfm_GetDTCStatus_DemEvent_Ref: destination=DemEventParameter  # Reference to the Dem event for the for Run Crank Low Diagnostic Status
        container Sum_Ssfm_Errh_SSCError [0..1]  # List of all possible DTC Errors.
          container Sum_Ssfm_Errh_U19A3_57_InvIncCfg [0..1]  # It contains the parameters concerning the DTC U19A3 57.
            boolean Sum_Ssfm_Errh_CodeGen_Enabled: set at pre-compile, default-value=true  # Boolean flag that enables/disables the generation of the DTC U19A3 57 handler code.
            boolean Sum_Ssfm_Errh_C_DTC_U19A3_57_InvIncCfg: set at pre-compile, default-value=true  # Boolean flag for controlling whether to enable the aggregation of DTC U19A3 57.
          container Sum_Ssfm_Errh_U19A3_92_SecPer_PerIncOp [0..1]  # It contains the parameters concerning the DTC U19A3 92.
            boolean Sum_Ssfm_Errh_CodeGen_Enabled: set at pre-compile, default-value=true  # Boolean flag that enables/disables the generation of the DTC U19A3 92 handler code.
            boolean Sum_Ssfm_Errh_C_DTC_U19A3_92_SecPer_PerIncOp: set at pre-compile, default-value=true  # Boolean flag for controlling whether to enable the DTC U19A3 92. Setting this parameter to true will let SSFM to aggregate U19A3 57 DTC.
          container Sum_Ssfm_Errh_U19A3_8A_CntrlModSecPer_AuthFailure [0..1]  # It contains the parameters concerning the DTC U19A3 8A.
            boolean Sum_Ssfm_Errh_CodeGen_Enabled: set at pre-compile, default-value=true  # Boolean flag that enables/disables the generation of the DTC U19A3 8A handler code.
          container Sum_Ssfm_Errh_U19A3_54_SecPer_MissSetup [0..1]  # It contains the parameters concerning the DTC U19A3 54.
            boolean Sum_Ssfm_Errh_C_DTC_U19A3_54_SecPer_MissSetup: set at pre-compile, default-value=true  # Boolean flag for controlling whether to enable the DTC U19A3 54. Setting this parameter to true will let SSFM to aggregate DTC U19A3 54 DTC.
          container Sum_Ssfm_Errh_U198C_8A_FailedAuth [0..1]  # It contains the parameters concerning the DTC U198C_8A.
            boolean Sum_Ssfm_Errh_CodeGen_Enabled: set at pre-compile, default-value=true  # Boolean flag that enables/disables the generation of the DTC U198C_8A handler code.
            reference Sum_Ssfm_VehicleRegion_SerialData_Ref: destination=Sum_Ssfm_SerialData  # Reference to the Serial Data of the vehicle region signal
            reference Sum_Ssfm_Errh_SSC_U198C_8A_EventFilter_Ref: destination=Sum_Ssfm_Errh_GeneralEventsFilter  # Reference to Sum_Ssfm_FilterType which is the filter type of SSC error event for U198C_8A status
          container Sum_Ssfm_Errh_U198C_54_MissSetup [0..1]  # It contains the parameters concerning the DTC U198C_54.
            boolean Sum_Ssfm_Errh_CodeGen_Enabled: set at pre-compile, default-value=true  # Boolean flag that enables/disables the generation of the DTC U198C_54 handler code.
            boolean Sum_Ssfm_Errh_C_DTC_U198C_54_MissSetup: set at pre-compile, default-value=true  # Boolean flag for controlling whether to enable the DTC U198C_54. Setting this parameter to true will let SSFM to aggregate DTC U198C_54 DTC.
            reference Sum_Ssfm_Errh_SSC_U198C_54_EventFilter_Ref [0..1]: destination=Sum_Ssfm_Errh_GeneralEventsFilter  # Reference to Sum_Ssfm_FilterType which is the filter type of SSC error event for U198C_54 status
          container Sum_Ssfm_Errh_U198C_49_PrimSec_IntElecFail [0..1]  # It contains the parameters concerning the DTC U198C_49 a primary security internal electronic failure.
            boolean Sum_Ssfm_Errh_U198C_49_DTCProcess: set at pre-compile, default-value=true  # Boolean flag for controlling whether to process DTC U198C 49 Status
            reference Sum_Ssfm_Errh_SSC_U198C_49_Filter_Ref [0..1]: destination=Sum_Ssfm_Errh_GeneralEventsFilter  # Reference to Sum_Ssfm_FilterType which is the filter type of SSC error event for U198C_49 Status.
        container Sum_Ssfm_Errh_SrvcMgrErrors [0..1]  # List of all possible DTC Errors for SrvcMgr.
          container Sum_Ssfm_Errh_U19A6_54_MissSetup [0..1]  # It contains the parameters concerning the DTC U19A6 54 - Service Discovery Failure ? Missing Setup/Learn.
            boolean Sum_Ssfm_Errh_C_DTC_U19A6_54_MissSetup: set at pre-compile, default-value=true  # Boolean flag for controlling whether to enable the DTC U19A6 54. Setting this parameter to true will let SSFM to aggregate DTC U19A6 54 DTC.
          container Sum_Ssfm_Errh_U19A6_57_PhyECUInvIncComp [0..1]  # It contains the parameters concerning the DTC U19A6_57 and confirms that DID E0CE is to be read.
            boolean Sum_Ssfm_Errh_U19A6_57_DTCProcess: set at pre-compile, default-value=true  # Boolean flag for controlling whether to enable the DTC U19A6_57.
            reference Sum_Ssfm_Errh_SrvcMgr_U19A6_57_Filter_Ref [0..1]: destination=Sum_Ssfm_Errh_GeneralEventsFilter  # Reference to Sum_Ssfm_FilterType which is the filter type for U19A6_57 status
          container Sum_Ssfm_Errh_U19A6_87_MissingMessage [0..1]  # It contains the parameters concerning the DTC U19A6 87 - Service Discovery Missing Message.
            boolean Sum_Ssfm_Errh_C_DTC_U19A6_87_MissingMessage: set at pre-compile, default-value=true  # Boolean flag for controlling whether to enable the DTC U19A6 87. Setting this parameter to true will let SSFM to aggregate DTC U19A6 87 DTC.
        container Sum_Ssfm_Errh_SafetySecurityErrors [0..1]  # List of all possible DTC Errors for Safety and Security.
          container Sum_Ssfm_Errh_UXXXX_83_SignalProtectionIncorrect [0..1]  # It contains the parameters concerning safety and security errors' DTCs - Value of Signal Protection Calculation Incorrect.
            boolean Sum_Ssfm_Errh_C_DTC_UXXXX_83_SignalProtectionIncorrect: set at pre-compile, default-value=true  # Boolean flag for controlling whether to enable the DTC UXXXX 81. Setting this parameter to true will let SSFM to aggregate Signal Protection Calculation DTCs.
          container Sum_Ssfm_Errh_UXXXX_87_MissingMessage [0..1]  # It contains the parameters concerning the DTC UXXXX 87 - Missing Message. Controls whether missing message DTC test enable condition is active.
            boolean Sum_Ssfm_Errh_C_DTC_UXXXX_87_MissingMessage: set at pre-compile, default-value=true  # Boolean flag for controlling whether to enable the DTC UXXXX 87. Setting this parameter to true will let SSFM to aggregate Missing Message DTCs.
      container Sum_Ssfm_ErrorFilter [0..1]  # List of all Filtering methods for Error handler
        float Sum_Ssfm_Errh_MovingWindow_XofY_Periodicity [0..1]: 1..65535, set at pre-compile in variant pre-compile / post-build in variant post-build  # SsfmRunMovWndTimBasedFunctionPeriod | Period (ms) of the Moving Window Time based Function Runnables. Counting the counter runnable to track the time interval compared to configured threshold for debouncer X of Y moving window time based .
        container Sum_Ssfm_Errh_GeneralEventsFilter [0..*]  # Definition of main error filters as X_OF_Y, BLOCK and, NONE.
          enumeration Sum_Ssfm_FilterType: {NONE, BLOCK, X_OF_Y_MOVING_WINDOW_TIMEBASED, X_OF_Y_MOVING_WINDOW_EVENTBASED}, set at pre-compile in variant pre-compile / post-build in variant post-build, default-value=NONE  # Configure the error filtering type
          integer Sum_Ssfm_Errh_C_ThrX [0..1]: 1..65535, set at pre-compile in variant pre-compile / post-build in variant post-build, origin=ETAS:1.0.0:2015-05-04  # Threshold for errors (X). Only applicable in the case of X_OF_Y filter type is selected.
          integer Sum_Ssfm_Errh_C_ThrY [0..1]: 1..65535, set at pre-compile in variant pre-compile / post-build in variant post-build  # Period in milliseconds or Number of events in which X threshold counter is valid. Only applicable in the case of X_OF_Y_TIME_BASED or X_OF_Y_TIME_COUNTER filter type is selected.
        container Sum_Ssfm_Errh_KeySlotVerifyFilter [0..1]  # The possible filter type values of SSC Key Slot Verify error properties
          boolean Sum_Ssfm_Errh_C_DTC_KeySlotVerify: set at pre-compile, origin=GM_ECUC, default-value=true  # Boolean flag for controlling whether to process DTC. If yes, the DTC shall be processed.
          reference Sum_Ssfm_GetDTCStatus_DemEvent_Ref: destination=DemEventParameter  # Reference to the DEM event associated for KeySlot Verify Error.
          reference Sum_Ssfm_DemDataElementClass_U19A3_8A_Ref [0..1]: destination=DemDataElementClass  # Reference to the Dem Data Element Class associated to the Freeze Frame of the DTC U19A3_8A.
          container Sum_Ssfm_Errh_KeySlotNumber [1..*]  # Container that defines KeySlots
            integer Sum_Ssfm_Errh_KeySlotVerify_QueueLength: 1..100, set at pre-compile, origin=GM_ECUC, default-value=5  # Parameter that defines the queue length for KeySlotVerify to support multiple message authentications. Hint: set the parameter at least the number of authenticated messages per KeySlot
            integer Sum_Ssfm_Errh_C_SlowestPDU_RateTimer: 50..12750, set at pre-compile in variant pre-compile / post-build in variant post-build, default-value=1000  # Timer in millisecond (ms) for determining when frames are not being received in this keyslot. This calibration shall be set equal to or greater than the periodic rate of the slowest PDU received on this keyslot.
            integer Sum_Ssfm_Errh_KeySlotProviderDTCId: 0..65535, set at pre-compile, origin=GM_ECUC, default-value=0  # DTC ID of the ECU that provides messages using this KeySlot for MAC verification.
            integer Sum_Ssfm_Errh_C_FailedAuthenticationTimer: 0..255, set at pre-compile in variant pre-compile / post-build in variant post-build, origin=ETAS:1.0.0:2015-05-04, default-value=59  # Timer in seconds for setting the threshold to report a "test failed".
    container Sum_Ssfm_Errh_DID [0..1]  # It contains the parameters related to the DID supported.
      container Sum_Ssfm_Errh_F094_LocalSupWdgMStsSOH [0..1]  # It contains the parameters to configure initial values of threshole and Time Window of filter and refer to the DcmDspDid for supporting DID 0xF094 Local Supervised WdgM Status Of SUM_SOH.
        integer SUM_ERRH_SOHSupFail_Thresh_Init [0..1]: 0..65535, origin=GM_ECUC, default-value=1  # Configure the Failed Local Supervision Threshold init value.
        integer SUM_ERRH_SOHSupFail_TW_Thresh_Init [0..1]: 0..16777215, origin=GM_ECUC, default-value=10  # Failed Local Supervision TW Threshold init.
        reference Sum_Ssfm_Errh_F094_Ref [0..1]: destination=DcmDspDid  # Reference to DcmDspDid of SUM_SOH Local Supervision Failures DID 0XF094 in DCM.
      container Sum_Ssfm_NvM_References  # Container for specifying the references to NvM blocks required by SUM_SFFM.
        reference Sum_Ssfm_CommFigureOfMeritNvmRef: destination=NvMBlockDescriptor  # Reference to the NvM block for DID 0xE0B8.
        reference Sum_Ssfm_SigStsInfoLossOfCommNvmRef: destination=NvMBlockDescriptor  # Reference to the NvM block for DID 0xE0B9.
        reference Sum_Ssfm_SigProtectionCalcIncorrectNvmRef: destination=NvMBlockDescriptor  # Reference to the NvM block for DID 0xE0BA.
        reference Sum_Ssfm_MACVerPerKSNvmRef [0..1]: destination=NvMBlockDescriptor  # Reference to the NvM block for DID 0xE0BB - MAC Verification Status Per Key Slot. This parameter shall be configured when key slot verification is enabled; otherwise, it does not need to be.
        reference Sum_Ssfm_LocalSupWdgMStsOfSOHNvmRef [0..1]: destination=NvMBlockDescriptor  # Reference to the NvM block for DID 0xF094. This parameter shall be configured when the SOH_ERRHLocalSupervision_SupportEnabled is True; otherwise, it does not need to be.
