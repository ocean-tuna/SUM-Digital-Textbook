AUTOSAR XML (schema 00051)
package /BuildActionManifests
  build action manifest Sum_Ssfm_Manifest
    build action Sum_Ssfm_Validate: category=VALIDATOR, invocation=sdg=[true, true], required-environment=com_bosch_configfw_bfwaction_oaw
      input-datas:
        {category=ARTIFACT, sdg=PROCESSOR, engineering-object={category=CONFWF, domain=CUBAS, short-label-pattern=Sum_Ssfm_Validate, file-type-pattern=oaw}}
        category=AR_OBJECT, sdg=DEFAULT_IN, ecuc-definition=SSFM
    build action Sum_Ssfm_Generate: category=GENERATOR, invocation=sdg=[1, true, true], predecessor-action=Sum_Ssfm_Validate, required-environment=com_bosch_configfw_bfwaction_oaw
      created-datas:
        {category=ARTIFACT, sdg=[MDF, DEFAULT_OUT], engineering-object={category=PJTSWCD, domain=CUBAS, short-label-pattern=Sum_Ssfm_Cfg_SWCD, file-type-pattern=arxml}}
        {category=ARTIFACT, sdg=[MDF, DEFAULT_OUT], engineering-object={category=PJTSRC, domain=CUBAS, short-label-pattern=Sum_Ssfm_Cfg, file-type-pattern=c}}
        {category=ARTIFACT, sdg=[MDF, DEFAULT_OUT], engineering-object={category=PJTSRC, domain=CUBAS, short-label-pattern=Sum_Ssfm_Cfg, file-type-pattern=h}}
        {category=ARTIFACT, sdg=[MDF, DEFAULT_OUT], engineering-object={category=PJTSRC, domain=CUBAS, short-label-pattern=Sum_Ssfm_QoS_Manager, file-type-pattern=c}}
        {category=ARTIFACT, sdg=[MDF, DEFAULT_OUT], engineering-object={category=PJTSRC, domain=CUBAS, short-label-pattern=Sum_Ssfm_QoS_Manager, file-type-pattern=h}}
        {category=ARTIFACT, sdg=[MDF, DEFAULT_OUT], engineering-object={category=PJTHDR, domain=CUBAS, short-label-pattern=Sum_Ssfm_EM_Ssm_Execution_Manager, file-type-pattern=c}}
        {category=ARTIFACT, sdg=[MDF, DEFAULT_OUT], engineering-object={category=PJTSRC, domain=CUBAS, short-label-pattern=Sum_Ssfm_EM_Ssm_Execution_Manager, file-type-pattern=h}}
        {category=ARTIFACT, sdg=[MDF, DEFAULT_OUT], engineering-object={category=PJTHDR, domain=CUBAS, short-label-pattern=Sum_Ssfm_EM_Errh_Execution_Manager, file-type-pattern=c}}
        {category=ARTIFACT, sdg=[MDF, DEFAULT_OUT], engineering-object={category=PJTSRC, domain=CUBAS, short-label-pattern=Sum_Ssfm_EM_Errh_Execution_Manager, file-type-pattern=h}}
        {category=ARTIFACT, sdg=[MDF, DEFAULT_OUT], engineering-object={category=PJTSRC, domain=CUBAS, short-label-pattern=Sum_Ssfm_FIM_ReceivedSerialData_Handler, file-type-pattern=c}}
        {category=ARTIFACT, sdg=[MDF, DEFAULT_OUT], engineering-object={category=PJTHDR, domain=CUBAS, short-label-pattern=Sum_Ssfm_FIM_ReceivedSerialData_Handler, file-type-pattern=h}}
        {category=ARTIFACT, sdg=[MDF, DEFAULT_OUT], engineering-object={category=PJTHDR, domain=CUBAS, short-label-pattern=Sum_Ssfm_FaultIndications_DataManager, file-type-pattern=c}}
        {category=ARTIFACT, sdg=[MDF, DEFAULT_OUT], engineering-object={category=PJTHDR, domain=CUBAS, short-label-pattern=Sum_Ssfm_FaultIndications_DataManager, file-type-pattern=h}}
        {category=ARTIFACT, sdg=[MDF, DEFAULT_OUT], engineering-object={category=PJTHDR, domain=CUBAS, short-label-pattern=Sum_Ssfm_FIM_SecurityStatus_Manager, file-type-pattern=c}}
        {category=ARTIFACT, sdg=[MDF, DEFAULT_OUT], engineering-object={category=PJTHDR, domain=CUBAS, short-label-pattern=Sum_Ssfm_FIM_SecurityStatus_Manager, file-type-pattern=h}}
        {category=ARTIFACT, sdg=[MDF, DEFAULT_OUT], engineering-object={category=PJTHDR, domain=CUBAS, short-label-pattern=Sum_Ssfm_FIM_ContOpStatus_Manager, file-type-pattern=c}}
        {category=ARTIFACT, sdg=[MDF, DEFAULT_OUT], engineering-object={category=PJTHDR, domain=CUBAS, short-label-pattern=Sum_Ssfm_FIM_ContOpStatus_Manager, file-type-pattern=h}}
        {category=ARTIFACT, sdg=[MDF, DEFAULT_OUT], engineering-object={category=PJTHDR, domain=CUBAS, short-label-pattern=Sum_Ssfm_FIM_SingleFxI_Manager, file-type-pattern=c}}
        {category=ARTIFACT, sdg=[MDF, DEFAULT_OUT], engineering-object={category=PJTHDR, domain=CUBAS, short-label-pattern=Sum_Ssfm_FIM_SingleFxI_Manager, file-type-pattern=h}}
        {category=ARTIFACT, sdg=[MDF, DEFAULT_OUT], engineering-object={category=PJTHDR, domain=CUBAS, short-label-pattern=Sum_Ssfm_FIM_ProtStatus_Manager, file-type-pattern=c}}
        {category=ARTIFACT, sdg=[MDF, DEFAULT_OUT], engineering-object={category=PJTHDR, domain=CUBAS, short-label-pattern=Sum_Ssfm_FIM_ProtStatus_Manager, file-type-pattern=h}}
        {category=ARTIFACT, sdg=[MDF, DEFAULT_OUT], engineering-object={category=PJTHDR, domain=CUBAS, short-label-pattern=Sum_Ssfm_FIM_SafetyStatus_Manager, file-type-pattern=c}}
        {category=ARTIFACT, sdg=[MDF, DEFAULT_OUT], engineering-object={category=PJTHDR, domain=CUBAS, short-label-pattern=Sum_Ssfm_FIM_SafetyStatus_Manager, file-type-pattern=h}}
        {category=ARTIFACT, sdg=[MDF, DEFAULT_OUT], engineering-object={category=PJTHDR, domain=CUBAS, short-label-pattern=Sum_Ssfm, file-type-pattern=h}}
        {category=ARTIFACT, sdg=[MDF, DEFAULT_OUT], engineering-object={category=PJTHDR, domain=CUBAS, short-label-pattern=Sum_Ssfm_Initialization, file-type-pattern=c}}
        {category=ARTIFACT, sdg=[MDF, DEFAULT_OUT], engineering-object={category=PJTSRC, domain=CUBAS, short-label-pattern=Sum_Ssfm_Initialization, file-type-pattern=h}}
        {category=ARTIFACT, sdg=[MDF, DEFAULT_OUT], engineering-object={category=PJTHDR, domain=CUBAS, short-label-pattern=Sum_Ssfm_DID_E0B9_Handler, file-type-pattern=c}}
        {category=ARTIFACT, sdg=[MDF, DEFAULT_OUT], engineering-object={category=PJTHDR, domain=CUBAS, short-label-pattern=Sum_Ssfm_DID_E0B9_Handler, file-type-pattern=h}}
        {category=ARTIFACT, sdg=[MDF, DEFAULT_OUT], engineering-object={category=PJTHDR, domain=CUBAS, short-label-pattern=Sum_Ssfm_MessageInfo_Handler, file-type-pattern=c}}
        {category=ARTIFACT, sdg=[MDF, DEFAULT_OUT], engineering-object={category=PJTHDR, domain=CUBAS, short-label-pattern=Sum_Ssfm_MessageInfo_Handler, file-type-pattern=h}}
        {category=ARTIFACT, sdg=[MDF, DEFAULT_OUT], engineering-object={category=PJTHDR, domain=CUBAS, short-label-pattern=Sum_Ssfm_LINInfo_Handler, file-type-pattern=c}}
        {category=ARTIFACT, sdg=[MDF, DEFAULT_OUT], engineering-object={category=PJTHDR, domain=CUBAS, short-label-pattern=Sum_Ssfm_LINInfo_Handler, file-type-pattern=h}}
        {category=ARTIFACT, sdg=[MDF, DEFAULT_OUT], engineering-object={category=PJTHDR, domain=CUBAS, short-label-pattern=Sum_Ssfm_NodeSts_Manager, file-type-pattern=c}}
        {category=ARTIFACT, sdg=[MDF, DEFAULT_OUT], engineering-object={category=PJTHDR, domain=CUBAS, short-label-pattern=Sum_Ssfm_NodeSts_Manager, file-type-pattern=h}}
        {category=ARTIFACT, sdg=[MDF, DEFAULT_OUT], engineering-object={category=PJTHDR, domain=CUBAS, short-label-pattern=Sum_Ssfm_CANETH_Av_Manager, file-type-pattern=c}}
        {category=ARTIFACT, sdg=[MDF, DEFAULT_OUT], engineering-object={category=PJTHDR, domain=CUBAS, short-label-pattern=Sum_Ssfm_CANETH_Av_Manager, file-type-pattern=h}}
        {category=ARTIFACT, sdg=[MDF, DEFAULT_OUT], engineering-object={category=PJTHDR, domain=CUBAS, short-label-pattern=Sum_Ssfm_LIN_Av_Manager, file-type-pattern=c}}
        {category=ARTIFACT, sdg=[MDF, DEFAULT_OUT], engineering-object={category=PJTHDR, domain=CUBAS, short-label-pattern=Sum_Ssfm_LIN_Av_Manager, file-type-pattern=h}}
        {category=ARTIFACT, sdg=[MDF, DEFAULT_OUT], engineering-object={category=PJTHDR, domain=CUBAS, short-label-pattern=Sum_Ssfm_SigStat_Av_Manager, file-type-pattern=c}}
        {category=ARTIFACT, sdg=[MDF, DEFAULT_OUT], engineering-object={category=PJTHDR, domain=CUBAS, short-label-pattern=Sum_Ssfm_SigStat_Av_Manager, file-type-pattern=h}}
        {category=ARTIFACT, sdg=[MDF, DEFAULT_OUT], engineering-object={category=PJTHDR, domain=CUBAS, short-label-pattern=Sum_Ssfm_Errh_EventDebouncer_Manager, file-type-pattern=c}}
        {category=ARTIFACT, sdg=[MDF, DEFAULT_OUT], engineering-object={category=PJTHDR, domain=CUBAS, short-label-pattern=Sum_Ssfm_Errh_EventDebouncer_Manager, file-type-pattern=h}}
        {category=ARTIFACT, sdg=[MDF, DEFAULT_OUT], engineering-object={category=PJTHDR, domain=CUBAS, short-label-pattern=Sum_Ssfm_Errh_U19A3_57_Handler, file-type-pattern=c}}
        {category=ARTIFACT, sdg=[MDF, DEFAULT_OUT], engineering-object={category=PJTHDR, domain=CUBAS, short-label-pattern=Sum_Ssfm_Errh_U19A3_57_Handler, file-type-pattern=h}}
        {category=ARTIFACT, sdg=[MDF, DEFAULT_OUT], engineering-object={category=PJTHDR, domain=CUBAS, short-label-pattern=Sum_Ssfm_Errh_U198C_49_Handler, file-type-pattern=c}}
        {category=ARTIFACT, sdg=[MDF, DEFAULT_OUT], engineering-object={category=PJTHDR, domain=CUBAS, short-label-pattern=Sum_Ssfm_Errh_U198C_49_Handler, file-type-pattern=h}}
        {category=ARTIFACT, sdg=[MDF, DEFAULT_OUT], engineering-object={category=PJTHDR, domain=CUBAS, short-label-pattern=Sum_Ssfm_Errh_U19A3_92_Handler, file-type-pattern=c}}
        {category=ARTIFACT, sdg=[MDF, DEFAULT_OUT], engineering-object={category=PJTHDR, domain=CUBAS, short-label-pattern=Sum_Ssfm_Errh_U19A3_92_Handler, file-type-pattern=h}}
        {category=ARTIFACT, sdg=[MDF, DEFAULT_OUT], engineering-object={category=PJTHDR, domain=CUBAS, short-label-pattern=Sum_Ssfm_Errh_U19A3_54_Handler, file-type-pattern=c}}
        {category=ARTIFACT, sdg=[MDF, DEFAULT_OUT], engineering-object={category=PJTHDR, domain=CUBAS, short-label-pattern=Sum_Ssfm_Errh_U19A3_54_Handler, file-type-pattern=h}}
        {category=ARTIFACT, sdg=[MDF, DEFAULT_OUT], engineering-object={category=PJTHDR, domain=CUBAS, short-label-pattern=Sum_Ssfm_Errh_U19A6_54_Handler, file-type-pattern=c}}
        {category=ARTIFACT, sdg=[MDF, DEFAULT_OUT], engineering-object={category=PJTHDR, domain=CUBAS, short-label-pattern=Sum_Ssfm_Errh_U19A6_54_Handler, file-type-pattern=h}}
        {category=ARTIFACT, sdg=[MDF, DEFAULT_OUT], engineering-object={category=PJTHDR, domain=CUBAS, short-label-pattern=Sum_Ssfm_Errh_U19A6_57_Handler, file-type-pattern=c}}
        {category=ARTIFACT, sdg=[MDF, DEFAULT_OUT], engineering-object={category=PJTHDR, domain=CUBAS, short-label-pattern=Sum_Ssfm_Errh_U19A6_57_Handler, file-type-pattern=h}}
        {category=ARTIFACT, sdg=[MDF, DEFAULT_OUT], engineering-object={category=PJTHDR, domain=CUBAS, short-label-pattern=Sum_Ssfm_Errh_U198C_8A_Handler, file-type-pattern=c}}
        {category=ARTIFACT, sdg=[MDF, DEFAULT_OUT], engineering-object={category=PJTHDR, domain=CUBAS, short-label-pattern=Sum_Ssfm_Errh_U198C_8A_Handler, file-type-pattern=h}}
        {category=ARTIFACT, sdg=[MDF, DEFAULT_OUT], engineering-object={category=PJTHDR, domain=CUBAS, short-label-pattern=Sum_Ssfm_Errh_U198C_54_Handler, file-type-pattern=c}}
        {category=ARTIFACT, sdg=[MDF, DEFAULT_OUT], engineering-object={category=PJTHDR, domain=CUBAS, short-label-pattern=Sum_Ssfm_Errh_U198C_54_Handler, file-type-pattern=h}}
        {category=ARTIFACT, sdg=[MDF, DEFAULT_OUT], engineering-object={category=PJTHDR, domain=CUBAS, short-label-pattern=Sum_Ssfm_Errh_U19A6_87_Handler, file-type-pattern=c}}
        {category=ARTIFACT, sdg=[MDF, DEFAULT_OUT], engineering-object={category=PJTHDR, domain=CUBAS, short-label-pattern=Sum_Ssfm_Errh_U19A6_87_Handler, file-type-pattern=h}}
        {category=ARTIFACT, sdg=[MDF, DEFAULT_OUT], engineering-object={category=PJTHDR, domain=CUBAS, short-label-pattern=Sum_Ssfm_Errh_U19A3_8A_Handler, file-type-pattern=c}}
        {category=ARTIFACT, sdg=[MDF, DEFAULT_OUT], engineering-object={category=PJTHDR, domain=CUBAS, short-label-pattern=Sum_Ssfm_Errh_BSW_Error_Management, file-type-pattern=h}}
        {category=ARTIFACT, sdg=[MDF, DEFAULT_OUT], engineering-object={category=PJTHDR, domain=CUBAS, short-label-pattern=Sum_Ssfm_Errh_BSW_Error_Management, file-type-pattern=c}}
        {category=ARTIFACT, sdg=[MDF, DEFAULT_OUT], engineering-object={category=PJTHDR, domain=CUBAS, short-label-pattern=Sum_Ssfm_Errh_U19A3_8A_Handler, file-type-pattern=h}}
        {category=ARTIFACT, sdg=[MDF, DEFAULT_OUT], engineering-object={category=PJTHDR, domain=CUBAS, short-label-pattern=Sum_Ssfm_Errh_CalibrationParameter_Handler, file-type-pattern=c}}
        {category=ARTIFACT, sdg=[MDF, DEFAULT_OUT], engineering-object={category=PJTHDR, domain=CUBAS, short-label-pattern=Sum_Ssfm_Errh_CalibrationParameter_Handler, file-type-pattern=h}}
        {category=ARTIFACT, sdg=[MDF, DEFAULT_OUT], engineering-object={category=PJTHDR, domain=CUBAS, short-label-pattern=Sum_Ssfm_Service_Manager, file-type-pattern=c}}
        {category=ARTIFACT, sdg=[MDF, DEFAULT_OUT], engineering-object={category=PJTHDR, domain=CUBAS, short-label-pattern=Sum_Ssfm_Service_Manager, file-type-pattern=h}}
        {category=ARTIFACT, sdg=[MDF, DEFAULT_OUT], engineering-object={category=PJTHDR, domain=CUBAS, short-label-pattern=Sum_Ssfm_SignalBased_MultipleProvider_Manager, file-type-pattern=c}}
        {category=ARTIFACT, sdg=[MDF, DEFAULT_OUT], engineering-object={category=PJTHDR, domain=CUBAS, short-label-pattern=Sum_Ssfm_SignalBased_MultipleProvider_Manager, file-type-pattern=h}}
        {category=ARTIFACT, sdg=[MDF, DEFAULT_OUT], engineering-object={category=PJTHDR, domain=CUBAS, short-label-pattern=Sum_Ssfm_SignalBased_Controller_DataManager, file-type-pattern=c}}
        {category=ARTIFACT, sdg=[MDF, DEFAULT_OUT], engineering-object={category=PJTHDR, domain=CUBAS, short-label-pattern=Sum_Ssfm_SignalBased_Controller_DataManager, file-type-pattern=h}}
        {category=ARTIFACT, sdg=[MDF, DEFAULT_OUT], engineering-object={category=PJTHDR, domain=CUBAS, short-label-pattern=Sum_Ssfm_ServiceBased_TrgDvc_DataManager, file-type-pattern=c}}
        {category=ARTIFACT, sdg=[MDF, DEFAULT_OUT], engineering-object={category=PJTHDR, domain=CUBAS, short-label-pattern=Sum_Ssfm_ServiceBased_TrgDvc_DataManager, file-type-pattern=h}}
        {category=ARTIFACT, sdg=[MDF, DEFAULT_OUT], engineering-object={category=PJTHDR, domain=CUBAS, short-label-pattern=Sum_Ssfm_DTCTriggeredMessage_Generator_Handler, file-type-pattern=c}}
        {category=ARTIFACT, sdg=[MDF, DEFAULT_OUT], engineering-object={category=PJTHDR, domain=CUBAS, short-label-pattern=Sum_Ssfm_DTCTriggeredMessage_Generator_Handler, file-type-pattern=h}}
        {category=ARTIFACT, sdg=[MDF, DEFAULT_OUT], engineering-object={category=PJTHDR, domain=CUBAS, short-label-pattern=Sum_Ssfm_RunCrankFault_Manager, file-type-pattern=c}}
        {category=ARTIFACT, sdg=[MDF, DEFAULT_OUT], engineering-object={category=PJTHDR, domain=CUBAS, short-label-pattern=Sum_Ssfm_RunCrankFault_Manager, file-type-pattern=h}}
        {category=ARTIFACT, sdg=[MDF, DEFAULT_OUT], engineering-object={category=PJTHDR, domain=CUBAS, short-label-pattern=Sum_Ssfm_Errh_Dtc_Enable_Manager, file-type-pattern=c}}
        {category=ARTIFACT, sdg=[MDF, DEFAULT_OUT], engineering-object={category=PJTHDR, domain=CUBAS, short-label-pattern=Sum_Ssfm_Errh_Dtc_Enable_Manager, file-type-pattern=h}}
        {category=ARTIFACT, sdg=[MDF, DEFAULT_OUT], engineering-object={category=PJTHDR, domain=CUBAS, short-label-pattern=Sum_Ssfm_LinBusOff_Handler, file-type-pattern=c}}
        {category=ARTIFACT, sdg=[MDF, DEFAULT_OUT], engineering-object={category=PJTHDR, domain=CUBAS, short-label-pattern=Sum_Ssfm_LinBusOff_Handler, file-type-pattern=h}}
        {category=ARTIFACT, sdg=[MDF, DEFAULT_OUT], engineering-object={category=PJTSRC, domain=CUBAS, short-label-pattern=Sum_Ssfm_SsmTypes, file-type-pattern=h}}
      input-datas:
        {category=ARTIFACT, sdg=PROCESSOR, engineering-object={category=CONFWF, domain=CUBAS, short-label-pattern=Sum_Ssfm_Generate, file-type-pattern=oaw}}
        category=AR_OBJECT, sdg=DEFAULT_IN, ecuc-definition=SSFM
