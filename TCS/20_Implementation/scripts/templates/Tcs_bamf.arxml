AUTOSAR XML (schema 00049)
package /RB_Manifest
  build action manifest Tcs_Manifest
    build action Tcs_Generator: category=GENERATOR, invocation=sdg=[true, 1, false], predecessor-action=Tcs_Validate, required-environment=com_bosch_configfw_bfwaction_oaw
      created-datas:
        {category=ARTIFACT, sdg=[MDF, DEFAULT_OUT], engineering-object={short-label=SUM_TCS_*, category=PJTHDR, domain=CUBAS, file-type=h}}
        {category=ARTIFACT, sdg=[MDF, DEFAULT_OUT], engineering-object={short-label=SUM_TCS_*, category=PJTSWCD, domain=CUBAS, file-type=arxml}}
        {category=ARTIFACT, sdg=[MDF, DEFAULT_OUT], engineering-object={short-label=SUM_TCS_*, category=PJTSRC, domain=CUBAS, file-type=c}}
      input-datas:
        {category=ARTIFACT, sdg=PROCESSOR, engineering-object={short-label=Tcs_Generate, category=CONFWF, domain=CUBAS, file-type=oaw}}
        category=AR_OBJECT, sdg=DEFAULT_IN, ecuc-definition=Tcs
    build action Tcs_Validate: category=VALIDATOR, invocation=sdg=[1, true, true], predecessor-action=Dem_IdGenerator, required-environment=com_bosch_configfw_bfwaction_oaw
      input-datas:
        {category=ARTIFACT, sdg=PROCESSOR, engineering-object={short-label=Tcs_Validate, category=CONFWF, domain=CUBAS, file-type=oaw}}
        category=AR_OBJECT, sdg=DEFAULT_IN, ecuc-definition=Tcs
