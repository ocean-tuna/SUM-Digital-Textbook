AUTOSAR XML (schema 4-0-3)
# COPYRIGHT RESERVED, 2020 ETAS GmbH. All rights reserved.
# The reproduction, distribution and utilization of this document as well as
# the communication of its contents to others without explicit authorization
# is prohibited. Offenders will be held liable for the payment of damages.
# All rights reserved in the event of the grant of a patent, utility model or
# design.
package /AUTOSAR_Tcs_Tcs/EcucModuleDefs
  module definition Tcs [0..1]: category=VENDOR_SPECIFIC_MODULE_DEFINITION, refined-module-def=Tcs, variants pre-compile/post-build  # Configuration of the Tcs module.
    container TcsGeneral  # General configuration of the TCS module.
      integer MasterClockPollingPeriodicity: 1..1000, set at pre-compile in variant pre-compile / post-build in variant post-build, origin=ETAS:1.0.0:2015-05-04, default-value=100  # Time in msec, for the periodicity of MasterClockPolling.
      integer PermitExecutionMask: 0..255, set at pre-compile in variant pre-compile / post-build in variant post-build, origin=ETAS:1.0.0:2015-05-04, default-value=254  # PermitExecution mask to start execution of the TCS module.
      integer SumTCSGlobalTimePrecision: 1..1000, set at pre-compile in variant pre-compile / post-build in variant post-build, origin=ETAS:1.0.0:2015-05-04, default-value=100  # Local time source accuracy in msec. Must be a multiple of the periodicity of TimeManagement.
      integer TimeManagementPeriodicity: 1..1000, set at pre-compile in variant pre-compile / post-build in variant post-build, origin=ETAS:1.0.0:2015-05-04, default-value=100  # Time in msec, for the periodicity of TimeManagement.
      boolean TcsGenerateInitRunnable: set at pre-compile in variant pre-compile / post-build in variant post-build, origin=RB:0.1.0:2015-12-05, default-value=false  # Configuration parameter TcsGenerateInitRunnable is used to allow the generation of a periodic runnable to run function RE_TCS_Init one time. If TRUE the Tcs should generate the periodic runnable to execute init() function one time otherwise, the init() function is called by a BswM action list during startup.
      float TcsInitFuncPeriodicity [0..1]: 1.0..5000.0, set at pre-compile in variant pre-compile / post-build in variant post-build, origin=ETAS:1.0.0:2015-05-04, default-value=1000.0  # Specifies time in millisecond, for the periodicity of the runnable RE_TCS_Init. Float values are supported. This parameter is required when TcsGenerateInitRunnable is set to TRUE
      reference DID_F129_TotalVehicleTimeValue_Reference: set at pre-compile, destination=DcmDspDid  # Reference to DCM DID 0xF129 Total Vehicle Time Value
      reference TcsDemTimestampRef: set at pre-compile, destination=DemDidClass  # Reference to Dem Timestamp
      reference TCSInitValueNvmRef: set at pre-compile in variant pre-compile / post-build in variant post-build, origin=ETAS:1.1.0:2015-07-15, destination=NvMBlockDescriptor  # Reference to NVM Block for storing TCS Init time value
      choice reference TCS_TimeSyncMessageSignalRef: set at pre-compile, destination=[ComGroupSignal, ComSignal]  # Reference to the TimeSyncMessage ComSignal or ComGroupSignal.
      foreign reference TCS_ServiceBased_TimeSyncMessage_DataTypeMappingSet [0..1]: destination-type=DATA-TYPE-MAPPING-SET  # Foreign reference to the DATA-TYPE-MAPPING-SET in the system extract used for service-based TimeSyncMessage. Required when TCS_ServiceBased_TimeSyncMessage_Ref is configured.
      foreign reference TCS_ServiceBased_TimeSyncMessage_Ref [0..1]: set at pre-compile, origin=RB, destination-type=IMPLEMENTATION-DATA-TYPE-ELEMENT  # Reference to the IMPLEMENTATION-DATA-TYPE-ELEMENT for service-based TimeSyncMessage from the system extract. Presence of this reference activates service-based mode.
