AUTOSAR XML (schema 4-0-3)
# COPYRIGHT RESERVED, 2020 ETAS GmbH. All rights reserved.
# The reproduction, distribution and utilization of this document as well as
# the communication of its contents to others without explicit authorization
# is prohibited. Offenders will be held liable for the payment of damages.
# All rights reserved in the event of the grant of a patent, utility model or
# design.
package /AUTOSAR
  module definition SOH [0..1]: refined-module-def=SOH, variants post-build  # Configuration of the SOH (State of Health Manager) module.
    container SOHGeneral  # General configuration parameters of the SOH.
      float SOH_RunnableSOHMainPeriod: 0.001..0.2, set at pre-compile, origin=GM_ECUC, default-value=0.1  # Time in sec, for the periodicity of the Runnable_SOH_Main
      float SOH_RunnableSOHTimingPeriod: 0.001..0.2, set at pre-compile, origin=GM_ECUC, default-value=0.1  # Time in sec, for the periodicity of the Runnable_SOH_Timing
      integer SOH_PermitExecution_Mask: 0..255, set at pre-compile, origin=GM_ECUC, default-value=190  # Mask that can be OR'd with the value supplied by PermitExecution.
      boolean SohGenerateInitRunnable: set at post-build, default-value=false  # Configuration parameter used to allow the generation of a periodic runnable to run function Runnable_SOH_Init one time. If TRUE the SOH should generate the periodic runnable to execute init() function one time, otherwise the init() function is called by a BswM action list during startup.
      float SohInitFuncPeriodicity [0..1]: 1.0..5000.0, set at pre-compile, default-value=1000.0  # Specifies time in milisecond, for the periodicity of the runnable Runnable_SOH_Init. Float values are supported. This parameter is required when SohGenerateInitRunnable is set to TRUE.
      boolean SOH_StatNvM_SupportEnabled: set at post-build, symbolic-name-value=true, default-value=true  # It allows to enable the NvM Status class and the relative detector.
      boolean SOH_ActNvM_SupportEnabled: set at post-build, symbolic-name-value=true, default-value=true  # It allows to enable the NvM Action class and the relative detector.
      boolean SOH_PrivNvM_SupportEnabled: set at post-build, symbolic-name-value=true, default-value=true  # It allows to enable the NvM Privilege class and the relative detector.
      boolean SOH_ExcepOS_SupportEnabled: set at post-build, symbolic-name-value=true, default-value=true  # It allows to enable the OS Hardware Protection class and the relative detector.
      boolean SOH_ServOS_SupportEnabled: set at post-build, symbolic-name-value=true, default-value=true  # It allows to enable the OS Service Protection / Trusted Function class and the relative detector.
      boolean SOH_StackOS_SupportEnabled: set at post-build, symbolic-name-value=true, default-value=true  # It allows to enable the OS Stack Fault class and the relative detector.
      boolean SOH_MemProtOS_SupportEnabled: set at post-build, symbolic-name-value=true, default-value=true  # It allows to enable the OS Memory Protection class and the relative detector.
      boolean SOH_TimeProtOS_SupportEnabled: set at post-build, symbolic-name-value=true, default-value=true  # It allows to enable the OS Time Protection class and the relative detector.
      boolean SOH_ErrOS_SupportEnabled: set at post-build, symbolic-name-value=true, default-value=true  # It allows to enable the Other OS Errors class and the relative detector.
      boolean SOH_ImmediateDelayed_SupportEnabled: set at post-build, symbolic-name-value=true, default-value=true  # It allows to enable (disable) for Immediate Reset Detector and Delayed Reset Detector in Reset Reliability monitor.
      boolean SOH_DiagnosticReset_SupportEnabled: set at post-build, symbolic-name-value=true, default-value=true  # It allows to enable (disable) for Diagnostic Reset Detector in Reset Reliability monitor.
      boolean SOH_ClearDiagnosticInformation_SupportEnabled: set at post-build, symbolic-name-value=true, default-value=true  # It allows to enable (disable) for Clear Diagnostic Information Accepted Request Detector and Clear Diagnostic Information Rejected Request Detector in Communication Reliability Monitor.
      boolean SOH_DiagnosticSessionControl_SupportEnabled: set at post-build, symbolic-name-value=true, default-value=true  # It allows to enable (disable) for Diagnostic Session Control Request Detector and Accepted Diagnostic Session Control Request Detector in Communication Reliability Monitor.
      boolean SOH_MACFailures_SupportEnabled: set at post-build, symbolic-name-value=true, default-value=true  # It allows to enable (disable) for MAC Failures Types 1 and 2 Detector and MAC Failures Type 3 Detector in Communication Reliability Monitor.
      boolean SOH_SecurityAccessFailures_SupportEnabled: set at post-build, symbolic-name-value=true, default-value=true  # It allows to enable (disable) for SecurityAccess (Service 0x27) Failures Detector in Communication Reliability Monitor.
      boolean SOH_SecPErrors_SupportEnabled: set at post-build, symbolic-name-value=true, default-value=true  # It allows to enable (disable) for SecP Errors Detector in Communication Reliability Monitor.
      boolean SOH_LocalSupervisionFailures_SupportEnabled: set at post-build, symbolic-name-value=true, default-value=true  # It allows to enable (disable) for Local Supervision Failures Detector in Watchdog Manager Reliability Monitor.
      boolean SOH_WdgMDEMSupervisionErrors_SupportEnabled: set at post-build, symbolic-name-value=true, default-value=true  # It allows to enable (disable) for WdgM DEM Supervision Errors Detector in Watchdog Manager Reliability Monitor.
      boolean SOH_ERRHLocalSupervision_SupportEnabled: set at post-build, symbolic-name-value=true, default-value=true  # It allows to enable (disable) for SUM_ERRH Local Supervision Detector in Watchdog Manager Reliability Monitor.
      boolean ERRH_SOHLocalSupervision_SupportEnabled: set at post-build, symbolic-name-value=true, default-value=true  # It allows to enable (disable) for SUM_SOH Local Supervision Detector in Watchdog Manager Reliability Monitor.
      boolean SOH_ShutdownDelay_SupportEnabled: set at post-build, symbolic-name-value=true, default-value=true  # It allows to enable (disable) for Shutdown Delay Detector in Platform Reliability Monitor.
      reference SOH_RID_02C0_SOH_Clear_Log_Reference: set at pre-compile, destination=DcmDspRoutine  # Reference to DCM RID 0x02C0 SOH Clear Logs
      reference SOH_OsCounterRef: destination=OsCounter  # Reference to the SOH specific Os Counter.
    container SOHConfigSet  # Container for the configuration parameters needed to set the initial value of calibration parameters.
      container SOH_ResetReliabilityMonitor  # SOH Reset Reliability Monitor container
        container SOH_ImmediateReset  # SOH Immediate Reset | SOH Immediate Reset container
          integer SUM_SOH_ImmeReset_Thresh_Init [0..1]: 0..65535, set at pre-compile, origin=GM_ECUC, default-value=1  # Immediate Reset Events Threshold init.
          integer SUM_SOH_ImmeReset_TW_Thresh_Init [0..1]: 0..16777215, set at pre-compile, origin=GM_ECUC, default-value=3600  # Immediate Reset Events Time WindowThreshold init.
          reference SOH_NvMImmResetDID_Reference [0..1]: set at pre-compile, destination=NvMBlockDescriptor  # Reference to NVM block for Immediate Reset DID
          reference SOH_DID_F08F_ImmResetData_Reference: set at pre-compile, destination=DcmDspData  # Reference to DCM ImmReset Data
        container SOH_DelayedReset  # SOH Delayed Reset | SOH Delayed Reset container
          integer SUM_SOH_DelayedReset_Thresh_Init [0..1]: 0..65535, set at pre-compile, origin=GM_ECUC, default-value=1  # Delayed Reset Events Threshold init.
          integer SUM_SOH_DelayedReset_TW_Thresh_Init [0..1]: 0..16777215, set at pre-compile, origin=GM_ECUC, default-value=3600  # Delayed Reset Events Time WindowThreshold init.
          reference SOH_NvMDelayedResetDID_Reference [0..1]: set at pre-compile, destination=NvMBlockDescriptor  # Reference to NVM block for Delayed Reset DID
          reference SOH_DID_F08F_DelayedResetData_Reference: set at pre-compile, destination=DcmDspData  # Reference to DCM DelayedReset Data
        container SOH_DiagnosticReset  # SOH Diagnostic Reset | SOH Diagnostic Reset container
          integer SUM_SOH_DiagReset_Thresh_Init [0..1]: 0..65535, set at pre-compile, origin=GM_ECUC, default-value=1  # Diagnostic Reset Events Threshold init.
          reference SOH_NvMDiagResetCntr_Reference [0..1]: set at pre-compile, destination=NvMBlockDescriptor  # Reference to NVM block for Diagnostic Reset Counter
          reference SOH_NvMDiagResetDID_Reference [0..1]: set at pre-compile, destination=NvMBlockDescriptor  # Reference to NVM block for Diagnostic Reset DID
          reference SOH_DID_F08F_DiagResetData_Reference: set at pre-compile, destination=DcmDspData  # Reference to DCM DiagReset Data Reference
      container SOH_MemoryStatusReliabilityMonitor  # SOH Memory Status Reliability Monitor container
        container SOH_NVMErrorsDetector  # SOH NVM Errors Detector | SOH NVM Errors Detector container
          container SOH_StatusNVM  # SOH StatusNVM Errors | SOH Status Failures/integrity NVM Errors container
            integer SUM_SOH_StatNVM_Thresh_Init [0..1]: 0..65535, set at pre-compile, origin=GM_ECUC, default-value=1  # Status Failures Integrity NVM Threshold init.
            integer SUM_SOH_StatNVM_TW_Thresh_Init [0..1]: 0..16777215, set at pre-compile, origin=GM_ECUC, default-value=3600  # Status Failures/integrity NVM Time WindowThreshold init.
            reference SOH_NvMStatNVMDID_Reference [0..1]: set at pre-compile, destination=NvMBlockDescriptor  # Reference to NVM block for StatusNVM Errors DID
            reference SOH_DID_F090_StatNVM_Reference: set at pre-compile, destination=DcmDspData  # Reference to DCM StatNVM Data
          container SOH_ActionNVM  # SOH ActionNVM Errors | SOH Action Failures NVM Errors container
            integer SUM_SOH_ActNVM_Thresh_Init [0..1]: 0..65535, set at pre-compile, origin=GM_ECUC, default-value=1  # Action Failures NVM Threshold init.
            integer SUM_SOH_ActNVM_TW_Thresh_Init [0..1]: 0..16777215, set at pre-compile, origin=GM_ECUC, default-value=3600  # Action Failures NVM Time WindowThreshold init.
            reference SOH_NvMActNVMDID_Reference [0..1]: set at pre-compile, destination=NvMBlockDescriptor  # Reference to NVM block for ActNVM Errors DID
            reference SOH_DID_F090_ActNVM_Reference: set at pre-compile, destination=DcmDspData  # Reference to DCM ActNVM Data
          container SOH_PrivilegeNVM  # SOH PrivilegeNVM Errors | SOH Privilege Failures NVM Errors container
            integer SUM_SOH_PrivNVM_Thresh_Init [0..1]: 0..65535, set at pre-compile, origin=GM_ECUC, default-value=1  # Privilege Failures NVM Threshold init.
            integer SUM_SOH_PrivNVM_TW_Thresh_Init [0..1]: 0..16777215, set at pre-compile, origin=GM_ECUC, default-value=3600  # Privilege Failures NVM Time WindowThreshold init.
            reference SOH_NvMPrivNVMDID_Reference [0..1]: set at pre-compile, destination=NvMBlockDescriptor  # Reference to NVM block for PrivNVM Errors DID
            reference SOH_DID_F090_PrivNVM_Reference: set at pre-compile, destination=DcmDspData  # Reference to DCM PrivNVM Data
        container SOH_OSErrorsDetector  # SOH OS Errors Detector | SOH OS Errors Detector container
          container SOH_ExcepOS  # SOH ExcepOS Errors | SOH Hardware Failures OS Errors container
            integer SUM_SOH_ExcepOS_Thresh_Init [0..1]: 0..65535, set at pre-compile, origin=GM_ECUC, default-value=1  # Status OS Hardware Protection Threshold init.
            integer SUM_SOH_ExcepOS_TW_Thresh_Init [0..1]: 0..16777215, set at pre-compile, origin=GM_ECUC, default-value=3600  # Status OS Hardware Protection Time WindowThreshold init.
            reference SOH_NvMExcepOSDID_Reference [0..1]: set at pre-compile, destination=NvMBlockDescriptor  # Reference to NVM block for OS Hardware Protection Errors DID
            reference SOH_DID_F090_ExcepOS_Reference: set at pre-compile, destination=DcmDspData  # Reference to DCM ExcepOS Data
          container SOH_ServOS  # SOH ServOS Errors | SOH OS Service Protection / Trusted Function Errors container
            integer SUM_SOH_ServOS_Thresh_Init [0..1]: 0..65535, set at pre-compile, origin=GM_ECUC, default-value=1  # OS Service Protection / Trusted Function Threshold init.
            integer SUM_SOH_ServOS_TW_Thresh_Init [0..1]: 0..16777215, set at pre-compile, origin=GM_ECUC, default-value=3600  # OS Service Protection / Trusted Function Time WindowThreshold init.
            reference SOH_NvMServOSDID_Reference [0..1]: set at pre-compile, destination=NvMBlockDescriptor  # Reference to NVM block for OS Service Protection / Trusted Function Errors DID
            reference SOH_DID_F090_ServOS_Reference: set at pre-compile, destination=DcmDspData  # Reference to DCM ServOS Data
          container SOH_StackOS  # SOH StackOS Errors | SOH OS Stack Fault Errors container
            integer SUM_SOH_StackOS_Thresh_Init [0..1]: 0..65535, set at pre-compile, origin=GM_ECUC, default-value=1  # OS Stack Fault Threshold init.
            integer SUM_SOH_StackOS_TW_Thresh_Init [0..1]: 0..16777215, set at pre-compile, origin=GM_ECUC, default-value=3600  # OS Stack Fault Time WindowThreshold init.
            reference SOH_NvMStackDID_Reference [0..1]: set at pre-compile, destination=NvMBlockDescriptor  # Reference to NVM block for OS Stack Fault Errors DID
            reference SOH_DID_F090_StackOS_Reference: set at pre-compile, destination=DcmDspData  # Reference to DCM StackOS Data
          container SOH_MemProtOS  # SOH MemProtOS Errors | SOH OS Memory Protection Errors container
            integer SUM_SOH_MemProtOS_Thresh_Init [0..1]: 0..65535, set at pre-compile, origin=GM_ECUC, default-value=1  # OS Memory Protection Threshold init.
            integer SUM_SOH_MemProtOS_TW_Thresh_Init [0..1]: 0..16777215, set at pre-compile, origin=GM_ECUC, default-value=3600  # OS Memory Protection Time WindowThreshold init.
            reference SOH_NvMMemProtOSDID_Reference [0..1]: set at pre-compile, destination=NvMBlockDescriptor  # Reference to NVM block for OS Memory Protection Errors DID
            reference SOH_DID_F090_MemProtOS_Reference: set at pre-compile, destination=DcmDspData  # Reference to DCM MemProtOS Data
          container SOH_TimeProtOS  # SOH TimeProtOS Errors | SOH OS Time Protection Errors container
            integer SUM_SOH_TimeProtOS_Thresh_Init [0..1]: 0..65535, set at pre-compile, origin=GM_ECUC, default-value=1  # OS Time Protection Threshold init.
            integer SUM_SOH_TimeProtOS_TW_Thresh_Init [0..1]: 0..16777215, set at pre-compile, origin=GM_ECUC, default-value=3600  # OS Time Protection Time WindowThreshold init.
            reference SOH_NvMTimeProtOSDID_Reference [0..1]: set at pre-compile, destination=NvMBlockDescriptor  # Reference to NVM block for OS Time Protection Errors DID
            reference SOH_DID_F090_TimeProtOS_Reference: set at pre-compile, destination=DcmDspData  # Reference to DCM TimeProtOS Data
          container SOH_ErrOS  # SOH ErrOS Errors | SOH Other OS Errors container
            integer SUM_SOH_ErrOS_Thresh_Init [0..1]: 0..65535, set at pre-compile, origin=GM_ECUC, default-value=1  # Other OS Errors Threshold init.
            integer SUM_SOH_ErrOS_TW_Thresh_Init [0..1]: 0..16777215, set at pre-compile, origin=GM_ECUC, default-value=3600  # Other OS Errors Time WindowThreshold init.
            reference SOH_NvMErrOSDID_Reference [0..1]: set at pre-compile, destination=NvMBlockDescriptor  # Reference to NVM block for Other OS Errors DID
            reference SOH_DID_F090_ErrOS_Reference: set at pre-compile, destination=DcmDspData  # Reference to DCM ErrOS Data
      container SOH_CommunicationReliabilityMonitor  # SOH Communication Reliability Monitor container
        container SOH_ClearDiagInfo  # SOH Clear Diagnostic Information Accepted Request | SOH Clear Diagnostic Information Accepted Request container
          integer SUM_SOH_ClearDiagInfo_Thresh_Init [0..1]: 0..65535, set at pre-compile, origin=GM_ECUC, default-value=1  # Clear Diagnostic Information Accepted Request Threshold init.
          reference SOH_NvMClearDiagInfoDID_Reference [0..1]: set at pre-compile, destination=NvMBlockDescriptor  # Reference to NVM block for Clear Diagnostic Information Accepted DID
          reference SOH_DID_F092_ClearDiagInfoDID_Reference: set at pre-compile, destination=DcmDspData  # Reference to DCM Clear Diag DID Data
        container SOH_RejectClearDiag  # SOH Clear Diagnostic Information Rejected Request | SOH Clear Diagnostic Information Rejected Request container
          integer SUM_SOH_Reject_ClearDiag_Init [0..1]: 0..65535, set at pre-compile, origin=GM_ECUC, default-value=1  # Clear Diagnostic Information Rejected Request Threshold init.
          reference SOH_NvMRejectClearDiagDID_Reference [0..1]: set at pre-compile, destination=NvMBlockDescriptor  # Reference to NVM block for Clear Diagnostic Information Rejected Request DID
          reference SOH_DID_F092_RejectClearDiagDID_Reference: set at pre-compile, destination=DcmDspData  # Reference to DCM Reject Clear Diag DID Data
        container SOH_DiagSession  # SOH Diagnostic Session Control Request | SOH Diagnostic Session Control Request container
          integer SUM_SOH_DiagSession_Thresh_Init [0..1]: 0..65535, set at pre-compile, origin=GM_ECUC, default-value=1  # Diagnostic Session Control Request Threshold init.
          reference SOH_NvMDiagSessionCntr_Reference [0..1]: set at pre-compile, destination=NvMBlockDescriptor  # Reference to NVM block for Diagnostic Session Control Request Counter
          reference SOH_NvMDiagSessionDID_Reference [0..1]: set at pre-compile, destination=NvMBlockDescriptor  # Reference to NVM block for Diagnostic Session Control Request DID
          reference SOH_DID_F092_DiagSessionDID_Reference: set at pre-compile, destination=DcmDspData  # Reference to DCM Diag Session DID Data
        container SOH_Accept_DiagSession  # SOH Accepted Diagnostic Session Control Request | SOH Accepted Diagnostic Session Control Request container
          integer SUM_SOH_Accept_DiagSession_Thresh_Init [0..1]: 0..65535, set at pre-compile, origin=GM_ECUC, default-value=1  # Accepted Diagnostic Session Control Request Threshold init.
          reference SOH_NvMAccept_DiagSessionCntr_Reference [0..1]: set at pre-compile, destination=NvMBlockDescriptor  # Reference to NVM block for Accepted Diagnostic Session Control Request Counter
          reference SOH_NvMAccept_DiagSessionDID_Reference [0..1]: set at pre-compile, destination=NvMBlockDescriptor  # Reference to NVM block for Accepted Diagnostic Session Control Request DID
          reference SOH_DID_F092_Accept_DiagSessionDID_Reference: set at pre-compile, destination=DcmDspData  # Reference to DCM Accept Diag Session DID Data
        container SOH_SecurityAccess  # SOH SecurityAccess (Service 0x27) Failures | SOH SecurityAccess (Service 0x27) Failures container
          integer SUM_SOH_SecurityAccess_Thresh_Init: 0..65535, set at pre-compile, origin=GM_ECUC, default-value=1  # SecurityAccess (Service 0x27) Failures Threshold init.
          reference SOH_NvMSecurityAccessCntr_Reference [0..1]: set at pre-compile, destination=NvMBlockDescriptor  # Reference to NVM block for SecurityAccess (Service 0x27) Failures Counter
          reference SOH_NvMSecurityAccessDID_Reference [0..1]: set at pre-compile, destination=NvMBlockDescriptor  # Reference to NVM block for SecurityAccess (Service 0x27) Failures DID
          reference SOH_DID_F092_SecurityAccessDID_Reference: set at pre-compile, destination=DcmDspData  # Reference to DCM Security Access DID Data
        container SOH_MACfailTenAct  # SOH MAC Failures Types 1 and 2 | SOH MAC Failures Types 1 and 2 container
          integer SUM_SOH_MACfail_TenAct_Thresh_Init [0..1]: 0..65535, set at pre-compile, origin=GM_ECUC, default-value=1  # MAC Failures Types 1 and 2 Threshold init.
          integer SUM_SOH_MACfail_TenAct_TW_Thresh_Init [0..1]: 0..65535, set at pre-compile, origin=GM_ECUC, default-value=2  # MAC Failures Types 1 and 2 TW Threshold init.
          reference SOH_NvMMACfail_TenActDID_Reference [0..1]: set at pre-compile, destination=NvMBlockDescriptor  # Reference to NVM block for MAC Failures Types 1 and 2 DID
          reference SOH_DID_F092_MACfail_TenActDID_Reference: set at pre-compile, destination=DcmDspData  # Reference to DCM MAC types 1 or 2 failures Data
        container SOH_ReplayCount  # SOH MAC Failures Type 3 | SOH MAC Failures Type 3 container
          integer SUM_SOH_ReplayCount_Thresh_Init [0..1]: 0..65535, set at pre-compile, origin=GM_ECUC, default-value=1  # MAC Failures Type 3 Threshold init.
          integer SUM_SOH_ReplayCount_TW_Thresh_Init [0..1]: 0..65535, set at pre-compile, origin=GM_ECUC, default-value=3600  # MAC Failures Type 3 TW Threshold init.
          integer SUM_SOH_ReplayCount_Start_Thresh_Init [0..1]: 0..255, set at pre-compile, origin=GM_ECUC, default-value=5  # Respect to the SOH initialization, MAC failures Type 3 Detector will delay a number of seconds before logging.
          reference SOH_NvMReplayCountDID_Reference [0..1]: set at pre-compile, destination=NvMBlockDescriptor  # Reference to NVM block for MAC Failures Type 3 DID
          reference SOH_DID_F092_ReplayCountDID_Reference: set at pre-compile, destination=DcmDspData  # Reference to DCM MAC types 3 failures DID Data
        container SOH_SecP  # SOH SecP Errors | SOH SecP Errors container
          integer SUM_SOH_SecP_Thresh_Init [0..1]: 0..65535, set at pre-compile, origin=GM_ECUC, default-value=1  # SecP Errors Threshold init.
          integer SUM_SOH_SecP_TW_Thresh_Init [0..1]: 0..65535, set at pre-compile, origin=GM_ECUC, default-value=3600  # SecP Errors TW Threshold init.
          reference SOH_NvMSecPDID_Reference [0..1]: set at pre-compile, destination=NvMBlockDescriptor  # Reference to NVM block for SecP Errors DID
          reference SOH_DID_F092_SecPDID_Reference: set at pre-compile, destination=DcmDspData  # Reference to DCM SecP Data
      container SOH_WatchdogManagerReliabilityMonitor  # SOH Watchdog Manager Reliability Monitor container
        container Local_Supervision_Failures_Detector  # Local Supervision Failures Detector container
          integer SUM_SOH_LocalStatFail_Thresh_Init [0..1]: 0..65535, set at pre-compile, origin=GM_ECUC, default-value=1  # Failed Local Supervision Threshold init.
          integer SUM_SOH_LocalStatFail_TW_Thresh_Init [0..1]: 0..65535, set at pre-compile, origin=GM_ECUC, default-value=10  # Failed Local Supervision TW Threshold init.
          reference Supervised_Entity_Reference [0..*]: set at pre-compile, destination=WdgMSupervisedEntity  # Reference to a Supervised Entity container in the WdgM. All the supervised entities (except ERRH and SOH) should be referenced by this parameter.
          reference SOH_LocalSupervisionFailures_DID_counter_Reference [0..1]: set at pre-compile, destination=NvMBlockDescriptor  # Reference to NVM block for Failed Local Supervision DID
          reference SOH_DID_F093_LocalStatFail_Reference: set at pre-compile, destination=DcmDspData  # Reference to DCM LocalStatFail Data
        container WdgM_DEM_Supervision_Errors_Detector  # WdgM DEM Supervision Errors Detector container
          integer SUM_SOH_WdgM_DEMErr_Thresh_Init [0..1]: 0..65535, set at pre-compile, origin=GM_ECUC, default-value=1  # Initial value of SUM_SOH_WdgM_DEMErr_Thresh.
          integer SUM_SOH_WdgM_DEMErr_TW_Thresh_Init [0..1]: 0..65535, set at pre-compile, origin=GM_ECUC, default-value=10  # Initial value of SUM_SOH_WdgM_DEMErr_TW_Thresh.
          reference SOH_WdgMDEMErr_DID_counter_Reference [0..1]: set at pre-compile, destination=NvMBlockDescriptor  # Reference to the NVM Block related to SUM_SOH_DID_WdgM_DEMErr_Cntr.
          reference SOH_DID_F093_WdgMDEMErr_Reference: set at pre-compile, destination=DcmDspData  # Reference to DCM WdgM DEM Err Data
        container SUM_ERRH_Local_Supervision_Detector  # SUM ERRH Local Supervision Detector container
          integer SOH_ERRHSupFail_Thresh_Init [0..1]: 0..65535, set at pre-compile, origin=GM_ECUC, default-value=1  # Initial value of SOH_ERRHSupFail_Thresh.
          integer SOH_ERRHSupFail_TW_Thresh_Init [0..1]: 0..65535, set at pre-compile, origin=GM_ECUC, default-value=10  # Initial value of SOH_ERRHSupFail_TW_Thresh.
          reference SOH_ERRHLocalSupervisionFailures_DID_counter_Reference [0..1]: set at pre-compile, destination=NvMBlockDescriptor  # Reference to the NVM Block related to SUM_SOH_DID_ERRHSupFail_Cntr.
          reference SOH_DID_F093_ERRHSupFail_Reference: set at pre-compile, destination=DcmDspData  # Reference to DCM ERRHSupFail Data
          reference SOH_DID_F093_ERRH_Local_Supervision_Status_Reference: set at pre-compile, destination=DcmDspData  # Reference to ERRH Local Supervision Status Data in DCM
      container SOH_PlatformReliabilityMonitor  # SOH Platform Reliability Monitor container
        container SOH_Shutdown  # SOH Shutdown Delay detector | SOH Shutdown Delay detector container
          integer SUM_SOH_Shutdown_Thresh_Init [0..1]: 0..65535, set at pre-compile, origin=GM_ECUC, default-value=1  # This parameter specifies the initial value of SUM_SOH_Shutdown_Thresh.
          integer SUM_SOH_Shutdown_Timer_Thresh_Init [0..1]: 0..65535, set at pre-compile, origin=GM_ECUC, default-value=60  # This parameter (in seconds) specifies the initial value of SUM_SOH_Shutdown_Timer_Thresh.
          reference SOH_NvMShutdownDID_Reference [0..1]: set at pre-compile, destination=NvMBlockDescriptor  # Reference to NVM block for Shutdown Delay detector DID.
          reference SOH_NvMShutdownCntr_Reference [0..1]: set at pre-compile, destination=NvMBlockDescriptor  # Reference to the NVM Counter Block for Shutdown Delay detector.
          reference SOH_DID_F091_ShutdownDID_Reference: set at pre-compile, destination=DcmDspData  # Reference to DCM Shutdown DID Data
