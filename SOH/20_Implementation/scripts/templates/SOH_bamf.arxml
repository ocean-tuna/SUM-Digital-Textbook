AUTOSAR XML (schema 00051)
package /BuildActionManifests
  build action manifest SOH_Manifest
    build action SOH_Generate: category=GENERATOR, invocation=sdg=[1, true, true, RBA-BSW], predecessor-action=SOH_Validate, input-datas=build-action-io-element={category=ARTIFACT, sdg=PROCESSOR, engineering-object={category=CONFWF, domain=CUBAS, short-label-pattern=SOH_generator, file-type-pattern=oaw}}, required-environment=com_bosch_configfw_bfwaction_oaw
      created-datas:
        {category=ARTIFACT, sdg=[MDF, DEFAULT_OUT], engineering-object={category=PJTSRC, domain=CUBAS, short-label-pattern=SUM_SOH_PBCfg, file-type-pattern=c}}
        {category=ARTIFACT, sdg=[MDF, DEFAULT_OUT], engineering-object={category=PJTHDR, domain=CUBAS, short-label-pattern=SUM_SOH, file-type-pattern=h}}
        {category=ARTIFACT, sdg=[MDF, DEFAULT_OUT], engineering-object={category=PJTSRC, domain=CUBAS, short-label-pattern=SUM_SOH_Cfg, file-type-pattern=c}}
        {category=ARTIFACT, sdg=[MDF, DEFAULT_OUT], engineering-object={category=PJTHDR, domain=CUBAS, short-label-pattern=SUM_SOH_Cfg, file-type-pattern=h}}
        {category=ARTIFACT, sdg=[MDF, DEFAULT_OUT], engineering-object={category=PJTHDR, domain=CUBAS, short-label-pattern=SUM_SOH_PBCfg, file-type-pattern=h}}
        {category=ARTIFACT, sdg=[MDF, DEFAULT_OUT], engineering-object={category=PJTSWCD, domain=CUBAS, short-label-pattern=SUM_SOH_Cfg_SWCD, file-type-pattern=arxml}}
        {category=ARTIFACT, sdg=[MDF, DEFAULT_OUT], engineering-object={category=PJTSRC, domain=CUBAS, short-label-pattern=SUM_SOH_ServicesRunnables, file-type-pattern=c}}
    build action SOH_Validate: category=VALIDATOR, invocation=sdg=[1, true, true, true], required-environment=com_bosch_configfw_bfwaction_oaw
      input-datas:
        {category=ARTIFACT, sdg=PROCESSOR, engineering-object={category=CONFWF, domain=CUBAS, short-label-pattern=SOH_Validate, file-type-pattern=oaw}}
        category=AR_OBJECT, sdg=DEFAULT_IN, ecuc-definition=SOH
