AUTOSAR XML (schema 00051)
# COPYRIGHT RESERVED, 2020 ETAS GmbH. All rights reserved.
# The reproduction, distribution and utilization of this document as well as
# the communication of its contents to others without explicit authorization
# is prohibited. Offenders will be held liable for the payment of damages.
# All rights reserved in the event of the grant of a patent, utility model or
# design.
package /AUTOSAR_Spm/EcucModuleDefs
  module definition Spm [0..1]: category=STANDARDIZED_MODULE_DEFINITION, refined-module-def=Spm  # Configuration of the SPM module
    container SpmConfigSet  # Container for the configuration of module instance specific set
      container SpmPowPrf [1..*]  # Container for the configuration of Power Profile. At least one power profile needs to be configured for the ECU.
        integer SpmSrvcAndInstID: ..4294967291  # The parameter defines the Profile associated software service identifier and the service instance number. Software service represents the 16 most significant bits of the configured number. The instance number the 16 less significant ones. It is assumed at least one profile is managed by the current node.
        integer SpmProfNumber: 0..255  # The parameter defines the Profile number.
        boolean SpmProfileIsLocal: default-value=False  # The parameter addresses if the current Power Profile is Local to the ECU or it is a remote service. For Local profile the value is TRUE.
        boolean SpmLocActivationAllowed: default-value=False  # The parameter defines if the profile can be locally activated. This means that the activation request can be done by an ECU-local SWC using CLIENT/SERVER operation. Only local profile can be activated from a local SWC. So the default value is FALSE.
        integer SpmApplIntfID [0..1]: 0..65535  # The parameter defines the profile enumeration value to be used for asking the profile activation locally. This parameter is configured only in case SpmLocActivationAllowed is TRUE. Lower multiplicity is 0 because it is valid only for local profiles
        integer SpmProfBitMapIndex [0..1]: 0..511  # The parameter maps the profile status as a specific bit of value. This value is reported by the DID E0DD and specified in SDV-6001.
        integer SpmProfActivationTimeOut [0..0]: 0..255  # OBSOLETE - NAMING MISMATCH
        integer SpmProfActivationTimeOutVehOff [0..1]: 0..65535, default-value=0  # The parameter defines the duration in Seconds of a valid timing-window before deactivating the profile automatically. Valid only for local profiles. The default value is 0, meaning that the profile is automatically deactivated when VehiclePowerMode is OFF.
        enumeration SpmVehONDefActPriorON [0..0]: {SPM_PRF_AP_NOTAPP, SPM_PRF_AP_LOW, SPM_PRF_AP_MEDIUM, SPM_PRF_AP_HIGH, SPM_PRF_AP_CRITICAL, SPM_PRF_AP_EMERGENCY}  # OBSOLETE - NAMING MISMATCH
        enumeration SpmVehDefActPriorON [0..1]: {SPM_PRF_AP_NOTAPP, SPM_PRF_AP_LOW, SPM_PRF_AP_MEDIUM_LOW, SPM_PRF_AP_MEDIUM, SPM_PRF_AP_MEDIUM_HIGH, SPM_PRF_AP_HIGH, SPM_PRF_AP_CRITICAL, SPM_PRF_AP_EMERGENCY, SPM_PRF_AP_ACCESS}, default-value=SPM_PRF_AP_NOTAPP  # The parameter defines the profile activation priority when vehicle is going to ON. The Lower multiplicity is 0 because it is valid only for local profiles, while the Upper multiplicity is 1 because it is unique for each profile. Default value is SPM_PRF_AP_NOTAPP.
        enumeration SpmVehDefActPriorOFF [0..1]: {SPM_PRF_AP_NOTAPP, SPM_PRF_AP_LOW, SPM_PRF_AP_MEDIUM_LOW, SPM_PRF_AP_MEDIUM, SPM_PRF_AP_MEDIUM_HIGH, SPM_PRF_AP_HIGH, SPM_PRF_AP_CRITICAL, SPM_PRF_AP_EMERGENCY, SPM_PRF_AP_ACCESS}, default-value=SPM_PRF_AP_NOTAPP  # The parameter defines the profile activation priority when vehicle is going to OFF. The Lower multiplicity is 0 because it is valid only for local profiles, while the Upper multiplicity is 1 because it is unique for each profile. The default value is SPM_PRF_AP_NOTAPP.
        reference SpmComIPduGroupEvnt_Tx [0..*]: destination=ComIPduGroup  # The parameter defines the reference to data PDU to enable/disable in Tx once a profile request has been satisfied if the configuration requires profile to be consumed.
        reference SpmComIPduGroupEvnt_Rx [0..*]: destination=ComIPduGroup  # The parameter defines the references to data PDU to enable/disable in Rx once a profile request has been satisfied if the configuration requires profile to be consumed.
        container SpmProfileSwDep [0..*]  # Container for the configuration of Power Profile Software Dependency
          enumeration SpmProfDepType: {SPM_PRF_DEP_ACT_AND_CONS, SPM_PRF_ACTIVATED, SPM_PRF_CONSUMED}, default-value=SPM_PRF_DEP_ACT_AND_CONS  # The parameter defines the type of dependency for the power profile. If SPM_PRF_DEP_ACT_AND_CONS then the profile is activated as services and services-data PDU are switched ON in RX by the current ECU instance. If SPM_PRF_ACTIVATED only service is activated. If SPM_PRF_CONSUMED only service-data pdu are switched ON in RX for the current ECU instance. All the dependencies need to be identified by this parameter (mandatory).
          reference SpmProfRef: destination=SpmPowPrf  # The parameter defines the reference to configured profile that acts as current profile dependency.
      container SpmPgttEntries  # Container for the configuration of Power Graph. SPM uses it for getting network information for its inter-ECU communication. Mandatory container.
        container SpmTrgDvc [1..*]  # Container for the configuration of Remote device information. At least one target device needs to be in communication with the current SPM instance.
          string SpmTrgDvcID [1..*]: max-length=15, min-length=7, regular-expression=[0-9]+\.[0-9]+\.[0-9]+\.[0-9]+  # The parameter defines all the IPv4 address for the target device. Each Target device could have more IP addresses since it can be reached from different VLAN.
          integer SpmTrgDvcDtcBaseID: 0..65535  # The parameter defines the base DTC (2 bytes) to set when the target communication is lost.
          integer SpmTrgDvcDtcTimeOut: 0..65535  # The parameter defines the maturation time to set when the target communication is lost.
          integer SpmTrgDvcPowerOnDeviceRetryPeriodicity [0..1]: 0..65535, default-value=10000  # This parameter defines the periodicity of the PowerOnDevice retry. Please, configure a value that it is greater than the sum of the SpmSeqStepDly of the wake-up sequence steps PLUS the value of SpmTrgDvcPowerOnDeviceWaitTimeBetweenOffandOnSequence PLUS the sum of the delay values between steps in the sequence PLUS the SpmTrgDvcDtcTimeOut of this TargetDevice. The value is in milliseconds.
          integer SpmTrgDvcPowerOnDeviceWaitTimeBetweenOffandOnSequence [0..1]: 0..65535, default-value=1000  # The parameter defines the time in milliseconds to wait between the OFF and ON sequence of the target device during the PowerOnDevice retry. Please, configure a value that it is greater than 250 ms to see changes in the WUF. The value it is in milliseconds.
          integer SpmTrgDvcDiagAddr [0..1]: 0..255, default-value=0  # The parameter defines the diagnostic address associated to the target for the diagnostic sessions.
          container SpmTrgDvcVariantHndlng [0..*]  # Per-variant configuration for a target device.
            enumeration SpmTrgAssocWkUpFrm [0..1]: {WKUP_FRM_A, WKUP_FRM_B, WKUP_FRM_C}  # Wake-up frame for this variant/target combination. Present only when Directly Managed by the Waking Device is True.
            integer SpmTrgAssocWkupBit [0..1]: 0..63  # Wake-up bit for this variant/target combination. Present only when Directly Managed by the Waking Device is True.
            reference SpmTrgDvcVariantRef: destination=SpmVariantCfg  # Reference to the SpmVariantCfg container identifying which variant this entry applies to.
            reference SpmWkUpSeqRef [0..1]: destination=SpmWkUpSeq  # The parameter defines the reference to the wake-up sequence to use. In case this value is not configured, then it means the target device is a requester for the current SPM.
        container SpmWkngDvc  # Container for the configuration of local node network configurations.
          enumeration SpmNodeType: {SPM_NODE_EDGE, SPM_NODE_INTERMEDIATE}, default-value=SPM_NODE_INTERMEDIATE  # The parameter defines the type of dependency for the power profile. The possibilities are SPM_NODE_EDGE and SPM_NODE_INTERMEDIATE. The default value is considering the node as an intermediate. Mandatory parameter.
        container SpmVariantCfg [1..*]  # Device-level configuration per variant. One instance per named variant. Always present - no-variant PGTT produces exactly one instance.
          enumeration SpmVariantWkupFrame: {WKUP_FRM_A, WKUP_FRM_B, WKUP_FRM_C}  # Wake-up frame for this variant. From Wakeup Frame Information per variant.
          integer SpmVariantWkupBit: 0..63, default-value=0  # Wake-up bit position (0..63) for this variant. From Wakeup Frame Information per variant.
          string SpmVariantIntermediateDstAddr [0..*]: max-length=15, min-length=7, regular-expression=[0-9]+\.[0-9]+\.[0-9]+\.[0-9]+  # IP address(es) of intermediate nodes for this variant. Mirrors SpmWkngDvc.SpmIntermediateDstAddrs for the no-variant path.
          container SpmVariantHBVLANCfg [1..*]  # Per-VLAN heartbeat network configuration for a hardware variant. One instance per VLAN per variant. Mirrors SpmWkngDvc network params for the no-variant path.
            integer SpmVLANId: 0..65535  # VLAN identifier for this variant heartbeat entry.
            string SpmSrcIp: max-length=15, min-length=7, regular-expression=[0-9]+\.[0-9]+\.[0-9]+\.[0-9]+  # Source IP address on this VLAN for this variant.
            string SpmDstIp: max-length=15, min-length=7, regular-expression=[0-9]+\.[0-9]+\.[0-9]+\.[0-9]+  # Multicast destination IP address on this VLAN for this variant.
        container SpmWkUpSeq [0..*]  # Container for the configuration of a wake-up sequence.
          integer SpmComStepSeparatPeridoForShutDownInit [0..0]: 1..65535, default-value=1  # (OBSOLETE - NOT SUPPORTED ANYMORE)parameter defines the type of command in the step
          container SpmWkUpStep [1..*]  # Container for the configuration of a specific step for a wake-up sequence.
            integer SpmStepID: 1..255  # parameter defines the type of command in the step
            enumeration SpmCommandType: {SEND_TC10_SWTCH_1, SEND_TC10_SWTCH_2, SEND_ETH_WKUP_FRM_A, SEND_ETH_WKUP_FRM_B, SEND_ETH_WKUP_FRM_C, SEND_CAN_WKUP_FRM_A, SEND_CAN_WKUP_FRM_B, SEND_CAN_WKUP_FRM_C, SEND_BOARD_LV_WKUP_GPIO}  # The parameter defines the type of command in the step. Each command type will address a different way to wake-up a target device.
            integer SpmCommandValue: 0..255  # parameter defines the value for the command step
            integer SpmSeqStepDly: 0..65535, default-value=0  # The parameter defines the delay in milliseconds to spend before executing the next step in the sequence. The value is mandatory but it is assumed 0 as default value.
      container SpmLowVoltagePowerInfo [0..1]  # Container for the configuration of LowVoltageSoftwareActivationPriorityRequest.
        integer SpmLowVoltLVOptmzerChkApplicationInterfaceID [0..1]: 0..65535  # LVOptmzerChk Application Interface ID of the power profile associated with the LV Energy Optimizer.
        reference SpmLowVoltSwActPrioReqSignal [0..1]: destination=ComSignal  # Reference to the ComSignal (Service Based) that carries the LowVoltageSoftwareActivationPriorityRequest information.
        foreign reference SpmLowVoltSwActPrioReqDataServiceBased [0..1]: destination-type=IMPLEMENTATION-DATA-TYPE-ELEMENT  # Reference to the implementation data type element for service based LowVoltageSoftwareActivationPriorityRequest.
        foreign reference SpmLowVoltSwActPrioReqDataTypeMappingSet [0..1]: destination-type=DATA-TYPE-MAPPING-SET  # Reference to the DATA-TYPE-MAPPING-SET in the system extract for service-based operations.
        reference SpmLowVoltSwActPrioNvmRef [0..1]: destination=NvMBlockDescriptor  # Reference to NvM LowVoltageSoftwareActivationPriorityRequest NvMBlockDescriptor.
    container SpmGeneral  # Container for the Configuration of project specific settings
      float SpmSMMainFuncPeriodicity: 5.0.., default-value=10.0  # Periodicity in milliseconds for the execution of SPM Software Manager functionalities.
      float SpmPMMainFuncPeriodicity: 5.0.., default-value=5.0  # (CURRENTLY NOT SUPPORTED. VALUE Fixed to 5ms) Periodicity in milliseconds for the execution of the SPM Power manager functionalities.
      integer SpmBurstPhsPeriodicity: 5.., default-value=5  # BurstPhsPeriodicity is a period less than the usual one, that happens as soon as SPM starts counting and sharing its heartbeat and the wake-up frame. This period is maintained for the first 3 counts. The parameter configures the message periodicity in milliseconds for this phase before switching to the normal one.
      integer SpmPermitExecutionMask: 0..255, default-value=254  # The parameter is a bitmap (1 Byte length) that defines the DON'T CARE wake-up sources that trigger the SPM execution. The DON'T CARE wake-up sources needs to be configured as 1.
      string SpmWkUpHelperFunction [0..1]: regular-expression=^\S*$  # The parameter defines the name of the wake-up helper function to be used by SPM, in case the ECU support the SDV-8217 defined Custom wake-up mechanism. The support of this function is valid only for intermediate nodes as CHM MCU.
      float SpmInitFuncPeriodicity [0..1]: 1.0..5000.0, default-value=1000.0  # Period in milliseconds that configures the runnable init function periodicity. This parameter is required when SpmGenerateInitRunnable is set to TRUE.
      boolean SpmGenerateInitRunnable: default-value=False  # The parameter shall generate SPM init runnable if it is configured as TRUE. Otherwise the SPM_Init() function shall be called by a BswM action list during startup
      integer Spm_SmFrame_QueueLength [0..1]: default-value=0  # Maximum queue length of SM Frame Rx messages. If the parameter is not configured it takes the number of target devices * number of local profiles as default value.
      integer Spm_PmHeartbeat_QueueLength [0..1]: default-value=0  # Maximum queue length of PM heartbeat Rx messages. If the parameter is not configured it takes the number of target devices as default value.
      integer Spm_PmETHwakeUpUNIC_QueueLength [0..1]: default-value=0  # Maximum queue length of PM eth wakeup Unicast Rx messages. If the parameter is not configured it takes the number of target devices as default value.
      integer Spm_PmETHwakeUpMULTIC_QueueLength [0..1]: default-value=0  # Maximum queue length of PM eth wakeup Multicast Rx messages. If the parameter is not configured it takes the following as a default value ((SM main function periodicity / 5) + 1) SM main function periodicity.
      integer Spm_LocalRequests_QueueLength [0..1]: default-value=0  # Maximum queue length of local activation/deactivatino requests as well as diagnostic requests. If the parameter is not configured it take the number of active profiles * 2 as default value.
      integer SpmHBShutdownDelayMs: 0..65000, default-value=2000  # Initial value for the calibration parameter indicating the time (in ms) the PM has to wait, after the last burst HeartBeat has been sent, before allowing the shutdown (Keep-Awake Timer)
      integer SpmSMStayAwakeTimeMs: 0..65000, default-value=2000  # Calibration parameter value indicating the time (in ms) during which the SM should stay awake if the only requester is in fault or restart state, before allowing shutdown.
      container SpmDiagnostic [0..1]  # Container with the reference needed for DIDs.
        reference spm_DID_E0DD_ActivationProfileActivationStatus_DCM_Ref [0..1]: destination=DcmDspDid  # Reference to the DcmDspDid for supporting DID 0xE0DD Activation Profile Activation Status
        reference SpmDID0xE0DEDcmRef [0..1]: destination=DcmDspDid  # Reference to the DcmDspDid for supporting DID 0xE0DE Locally Activated Activation Profile Off Power Mode Activity Records
        reference SpmDID0xE0DFDcmRef [0..1]: destination=DcmDspDid  # Reference to the DcmDspDid for supporting DID 0xE0DF Remotely Activated Activation Profile Off Power Mode Activity Records
        reference SpmDID0xE0DENvmRef [0..1]: destination=NvMBlockDescriptor  # Reference to the NvM block for DID 0xE0DE Locally Activated Activation Profile Off Power Mode Activity Records
        reference SpmDID0xE0DFNvmRef [0..1]: destination=NvMBlockDescriptor  # Reference to the NvM block for DID 0xE0DF Remotely Activated Activation Profile Off Power Mode Activity Records
      container SpmETHWkUpFrmRef [0..0]  # Container with the reference to the ETH wake-up frame.
        reference SpmETHSwitchNetwork [0..0]: destination=EthSMNetwork  # Reference to the network handle ID
        reference SpmETHWkUpFrmTxRef [0..0]: destination=SoAdPduRoute  # Reference to the SOAd Pdu in Tx
        reference SpmETHWkUpFrmRxRef [0..0]: destination=SoAdSocketRoute  # Reference to the SOAd Pdu in Rx
      container SpmCANWkUpFrmRef [0..1]  # Container for the configuration of the SPM used CAN wake-up frames
        reference SpmCANWkUpFrmTxRef [0..3]: destination=CanIfTxPduCfg  # parameters defines the references to CanIfPdu in Tx side for SPM CAN wake-up frames
        reference SpmCANWkUpFrmRxRef [0..*]: destination=CanIfRxPduCfg  # parameters defines the references to CanIfPdu in Rx side for SPM CAN wake-up frames
      container SpmVLANCom [1..*]  # Container for the configuration of VLAN communication for configurable interfaces and data types.
        integer SpmVLANId: 0..255  # The parameter defines the VLAN identifier for the configured interface.
        container SpmVLANComPwrMgrHeartbeat [0..1]  # Container for the configuration of VLAN communication items for heartbeat frames.
          string SpmHbTxAbsPth [0..1]: regular-expression=^\/\S*$  # The parameter defines absolute XML path in the extract in which the VLAN sender-receiver interface is defined.
          string SpmHbRxAbsPth [0..1]: regular-expression=^\/\S*$  # The parameter defines absolute XML path in the extract in which the VLAN sender-receiver interface Implementation Data Type is defined.
          foreign reference SpmPwrMgrHeartbeatTxImpDataTypeRef [0..1]: destination-type=IMPLEMENTATION-DATA-TYPE  # parameters defines the references to PwrMgrHeartbeat Tx Implementation Data Type
          foreign reference SpmPwrMgrHeartbeatTxSendRecvIntRef [0..1]: destination-type=SENDER-RECEIVER-INTERFACE  # parameters defines the references to PwrMgrHeartbeat Tx Sender Receiver Interface
          foreign reference SpmPwrMgrHeartbeatRxImpDataTypeRef [0..*]: destination-type=IMPLEMENTATION-DATA-TYPE  # parameters defines the references to PwrMgrHeartbeat Rx Implementation Data Type
          foreign reference SpmPwrMgrHeartbeatRxSendRecvIntRef [0..*]: destination-type=SENDER-RECEIVER-INTERFACE  # parameters defines the references to PwrMgrHeartbeat Rx Sender Receiver Interface
        container SpmVLANComPwrMgrWakeupFrames [0..1]  # Container for the configuration of VLAN communication items for wake-up frames.
          string SpmWkupTxAbsPth [0..1]: regular-expression=^\/\S*$  # The parameter defines absolute XML path in the extract in which the VLAN sender-receiver interface is defined.
          string SpmWkupRxAbsPth [0..1]: regular-expression=^\/\S*$  # The parameter defines absolute XML path in the extract in which the VLAN sender-receiver interface Implementation Data Type is defined.
          foreign reference SpmPwrMgrWakeupTxImpDataTypeRef [0..1]: destination-type=IMPLEMENTATION-DATA-TYPE  # parameters defines the references to PwrMgrWakeup Tx Implementation Data Type
          foreign reference SpmPwrMgrWakeupRxImpDataTypeRef [0..1]: destination-type=IMPLEMENTATION-DATA-TYPE  # parameters defines the references to PwrMgrWakeup Rx Implementation Data Type
          foreign reference SpmPwrMgrWakeupTxSendRecvIntRef [0..1]: destination-type=SENDER-RECEIVER-INTERFACE  # parameters defines the references to PwrMgrWakeup Tx Sender Receiver Interface
          foreign reference SpmPwrMgrWakeupRxSendRecvIntRef [0..1]: destination-type=SENDER-RECEIVER-INTERFACE  # parameters defines the references to PwrMgrWakeup Rx Sender Receiver Interface
        container SpmVLANComPwrMgrWakeupFramesMulticast [0..1]  # Container for the configuration of VLAN communication items for wake-up frames multicast.
          string SpmWkupRxAbsPthMulticast [0..1]: regular-expression=^\/\S*$  # The parameter defines absolute XML path in the extract in which the VLAN sender-receiver interface Implementation Data Type is defined.
          foreign reference SpmPwrMgrWakeupRxImpDataTypeMulticastRef [0..1]: destination-type=IMPLEMENTATION-DATA-TYPE  # parameters defines the references to PwrMgrWakeup Rx Multicast Implementation Data Type
          foreign reference SpmPwrMgrWakeupRxSendRecvIntMulticastRef [0..1]: destination-type=SENDER-RECEIVER-INTERFACE  # parameters defines the references to PwrMgrWakeup Rx Multicast Sender Receiver Interface
        container SpmVLANComSwrMgrInfo [0..1]  # Container for the configuration of VLAN communication items for software manager info frames
          string SpmSmTxAbsPth [0..1]: regular-expression=^\/\S*$  # The parameter defines absolute XML path in the extract in which the VLAN sender-receiver interface is defined.
          string SpmSmRxAbsPth [0..1]: regular-expression=^\/\S*$  # The parameter defines absolute XML path in the extract in which the VLAN sender-receiver interface Implementation Data Type is defined.
          foreign reference SpmSwMgrInfoTxImpDataTypeRef [0..1]: destination-type=IMPLEMENTATION-DATA-TYPE  # parameters defines the references to SwMgrInfo Tx Implementation Data Type
          foreign reference SpmSwMgrInfoRxImpDataTypeRef [0..1]: destination-type=IMPLEMENTATION-DATA-TYPE  # parameters defines the references to SwMgrInfo Rx Implementation Data Type
          foreign reference SpmSwMgrInfoTxSendRecvIntRef [0..1]: destination-type=SENDER-RECEIVER-INTERFACE  # parameters defines the references to SwMgrInfo Tx Sender Receiver Interface
          foreign reference SpmSwMgrInfoRxSendRecvIntRef [0..1]: destination-type=SENDER-RECEIVER-INTERFACE  # parameters defines the references to SwMgrInfo Rx Sender Receiver Interface
