AUTOSAR XML (schema 00051)
package /BuildActionManifests
  build action manifest Sum_Spm_Manifest
    build action Sum_Spm_Validate: category=VALIDATOR, invocation=sdg=true, required-environment=com_bosch_configfw_bfwaction_oaw
      input-datas:
        {category=ARTIFACT, sdg=PROCESSOR, engineering-object={category=CONFWF, domain=CUBAS, short-label-pattern=Sum_Spm_Validate, file-type-pattern=oaw}}
        category=AR_OBJECT, sdg=DEFAULT_IN, ecuc-definition=Spm
    build action Sum_Spm_Generate: category=GENERATOR, invocation=sdg=[1, true, true], predecessor-action=Sum_Spm_Validate, required-environment=com_bosch_configfw_bfwaction_oaw
      created-datas:
        {category=ARTIFACT, sdg=[MDF, DEFAULT_OUT], engineering-object={category=PJTSWCD, domain=CUBAS, short-label-pattern=Sum_Spm_Cfg_CDD, file-type-pattern=arxml}}
        {category=ARTIFACT, sdg=[MDF, DEFAULT_OUT], engineering-object={category=PJTSWCD, domain=CUBAS, short-label-pattern=Sum_SpmTypes, file-type-pattern=h}}
        {category=ARTIFACT, sdg=[MDF, DEFAULT_OUT], engineering-object={category=PJTSWCD, domain=CUBAS, short-label-pattern=Sum_Spm_Cfg, file-type-pattern=h}}
        {category=ARTIFACT, sdg=[MDF, DEFAULT_OUT], engineering-object={category=PJTSWCD, domain=CUBAS, short-label-pattern=Sum_Spm_Cfg, file-type-pattern=c}}
        {category=ARTIFACT, sdg=[MDF, DEFAULT_OUT], engineering-object={category=PJTSWCD, domain=CUBAS, short-label-pattern=Sum_Spm_WakeUpHelper, file-type-pattern=h}}
        {category=ARTIFACT, sdg=[MDF, DEFAULT_OUT], engineering-object={category=PJTSWCD, domain=CUBAS, short-label-pattern=Sum_Spm_PBCfg, file-type-pattern=h}}
        {category=ARTIFACT, sdg=[MDF, DEFAULT_OUT], engineering-object={category=PJTSWCD, domain=CUBAS, short-label-pattern=Sum_Spm_PBCfg, file-type-pattern=c}}
        {category=ARTIFACT, sdg=[MDF, DEFAULT_OUT], engineering-object={category=PJTSWCD, domain=CUBAS, short-label-pattern=Sum_Spm_SoftwMgr, file-type-pattern=c}}
        {category=ARTIFACT, sdg=[MDF, DEFAULT_OUT], engineering-object={category=PJTSWCD, domain=CUBAS, short-label-pattern=Sum_Spm_SoftwMgr, file-type-pattern=h}}
        {category=ARTIFACT, sdg=[MDF, DEFAULT_OUT], engineering-object={category=PJTSWCD, domain=CUBAS, short-label-pattern=Sum_Spm_PowerProfileStateMachine, file-type-pattern=h}}
        {category=ARTIFACT, sdg=[MDF, DEFAULT_OUT], engineering-object={category=PJTSWCD, domain=CUBAS, short-label-pattern=Sum_Spm_RequesterLst, file-type-pattern=h}}
        {category=ARTIFACT, sdg=[MDF, DEFAULT_OUT], engineering-object={category=PJTSWCD, domain=CUBAS, short-label-pattern=Sum_Spm_RequesterLst, file-type-pattern=c}}
        {category=ARTIFACT, sdg=[MDF, DEFAULT_OUT], engineering-object={category=PJTSWCD, domain=CUBAS, short-label-pattern=Sum_Spm_WakeUp, file-type-pattern=h}}
        {category=ARTIFACT, sdg=[MDF, DEFAULT_OUT], engineering-object={category=PJTSWCD, domain=CUBAS, short-label-pattern=Sum_Spm_WakeUp, file-type-pattern=c}}
        {category=ARTIFACT, sdg=[MDF, DEFAULT_OUT], engineering-object={category=PJTSWCD, domain=CUBAS, short-label-pattern=Sum_Spm_SrvcMgrIf, file-type-pattern=c}}
        {category=ARTIFACT, sdg=[MDF, DEFAULT_OUT], engineering-object={category=PJTSWCD, domain=CUBAS, short-label-pattern=Sum_Spm_MetaData, file-type-pattern=h}}
        {category=ARTIFACT, sdg=[MDF, DEFAULT_OUT], engineering-object={category=PJTSWCD, domain=CUBAS, short-label-pattern=Sum_Spm_SrvcMgrIf, file-type-pattern=h}}
        {category=ARTIFACT, sdg=[MDF, DEFAULT_OUT], engineering-object={category=PJTSWCD, domain=CUBAS, short-label-pattern=Sum_Spm_VariantManagement, file-type-pattern=h}}
        {category=ARTIFACT, sdg=[MDF, DEFAULT_OUT], engineering-object={category=PJTSWCD, domain=CUBAS, short-label-pattern=Sum_Spm_VariantManagement, file-type-pattern=c}}
        {category=ARTIFACT, sdg=[MDF, DEFAULT_OUT], engineering-object={category=PJTSWCD, domain=CUBAS, short-label-pattern=Sum_Spm_PwrMgr, file-type-pattern=h}}
        {category=ARTIFACT, sdg=[MDF, DEFAULT_OUT], engineering-object={category=PJTSWCD, domain=CUBAS, short-label-pattern=Sum_Spm_PwrMgr, file-type-pattern=c}}
        {category=ARTIFACT, sdg=[MDF, DEFAULT_OUT], engineering-object={category=PJTSWCD, domain=CUBAS, short-label-pattern=Sum_Spm_Services, file-type-pattern=h}}
        {category=ARTIFACT, sdg=[MDF, DEFAULT_OUT], engineering-object={category=PJTSWCD, domain=CUBAS, short-label-pattern=Sum_Spm_Services, file-type-pattern=c}}
        {category=ARTIFACT, sdg=[MDF, DEFAULT_OUT], engineering-object={category=PJTSWCD, domain=CUBAS, short-label-pattern=Sum_Spm_Diagnostic, file-type-pattern=h}}
        {category=ARTIFACT, sdg=[MDF, DEFAULT_OUT], engineering-object={category=PJTSWCD, domain=CUBAS, short-label-pattern=Sum_Spm_Diagnostic, file-type-pattern=c}}
        {category=ARTIFACT, sdg=[MDF, DEFAULT_OUT], engineering-object={category=PJTSWCD, domain=CUBAS, short-label-pattern=Sum_Spm_ErrorHandler, file-type-pattern=h}}
        {category=ARTIFACT, sdg=[MDF, DEFAULT_OUT], engineering-object={category=PJTSWCD, domain=CUBAS, short-label-pattern=Sum_Spm_ErrorHandler, file-type-pattern=c}}
        {category=ARTIFACT, sdg=[MDF, DEFAULT_OUT], engineering-object={category=PJTSWCD, domain=CUBAS, short-label-pattern=Sum_Spm_PowerOnDevice, file-type-pattern=h}}
        {category=ARTIFACT, sdg=[MDF, DEFAULT_OUT], engineering-object={category=PJTSWCD, domain=CUBAS, short-label-pattern=Sum_Spm_PowerOnDevice, file-type-pattern=c}}
        {category=ARTIFACT, sdg=[MDF, DEFAULT_OUT], engineering-object={category=PJTSWCD, domain=CUBAS, short-label-pattern=Sum_Spm_SM_Req_EthIf, file-type-pattern=h}}
        {category=ARTIFACT, sdg=[MDF, DEFAULT_OUT], engineering-object={category=PJTSWCD, domain=CUBAS, short-label-pattern=Sum_Spm_SM_Req_EthIf, file-type-pattern=c}}
        {category=ARTIFACT, sdg=[MDF, DEFAULT_OUT], engineering-object={category=PJTSWCD, domain=CUBAS, short-label-pattern=Sum_Spm_Request_Queue, file-type-pattern=h}}
        {category=ARTIFACT, sdg=[MDF, DEFAULT_OUT], engineering-object={category=PJTSWCD, domain=CUBAS, short-label-pattern=Sum_Spm_Request_Queue, file-type-pattern=c}}
        {category=ARTIFACT, sdg=[MDF, DEFAULT_OUT], engineering-object={category=PJTSWCD, domain=CUBAS, short-label-pattern=Sum_Spm_DevicePowerState, file-type-pattern=h}}
        {category=ARTIFACT, sdg=[MDF, DEFAULT_OUT], engineering-object={category=PJTSWCD, domain=CUBAS, short-label-pattern=Sum_Spm_DevicePowerState, file-type-pattern=c}}
        {category=ARTIFACT, sdg=[MDF, DEFAULT_OUT], engineering-object={category=PJTSWCD, domain=CUBAS, short-label-pattern=Sum_Spm_HeartBeat_Mgr, file-type-pattern=h}}
        {category=ARTIFACT, sdg=[MDF, DEFAULT_OUT], engineering-object={category=PJTSWCD, domain=CUBAS, short-label-pattern=Sum_Spm_HeartBeat_Mgr, file-type-pattern=c}}
        {category=ARTIFACT, sdg=[MDF, DEFAULT_OUT], engineering-object={category=PJTSWCD, domain=CUBAS, short-label-pattern=Sum_Spm_Request_Queue, file-type-pattern=h}}
        {category=ARTIFACT, sdg=[MDF, DEFAULT_OUT], engineering-object={category=PJTSWCD, domain=CUBAS, short-label-pattern=Sum_Spm_Request_Queue, file-type-pattern=c}}
        {category=ARTIFACT, sdg=[MDF, DEFAULT_OUT], engineering-object={category=PJTSWCD, domain=CUBAS, short-label-pattern=Sum_Spm_MetaData, file-type-pattern=h}}
        {category=ARTIFACT, sdg=[MDF, DEFAULT_OUT], engineering-object={category=PJTSWCD, domain=CUBAS, short-label-pattern=Sum_Spm_Cbk, file-type-pattern=h}}
        {category=ARTIFACT, sdg=[MDF, DEFAULT_OUT], engineering-object={category=PJTSWCD, domain=CUBAS, short-label-pattern=Sum_Spm_MetaData, file-type-pattern=c}}
        {category=ARTIFACT, sdg=[MDF, DEFAULT_OUT], engineering-object={category=PJTSWCD, domain=CUBAS, short-label-pattern=Sum_Spm_Cbk, file-type-pattern=c}}
        {category=ARTIFACT, sdg=[MDF, DEFAULT_OUT], engineering-object={category=PJTSWCD, domain=CUBAS, short-label-pattern=Sum_Spm, file-type-pattern=h}}
        {category=ARTIFACT, sdg=[MDF, DEFAULT_OUT], engineering-object={category=PJTSWCD, domain=CUBAS, short-label-pattern=Sum_Spm_Interaction_VehicleEnergyOptimizer, file-type-pattern=h}}
        {category=ARTIFACT, sdg=[MDF, DEFAULT_OUT], engineering-object={category=PJTSWCD, domain=CUBAS, short-label-pattern=Sum_Spm_Interaction_VehicleEnergyOptimizer, file-type-pattern=c}}
      input-datas:
        {category=ARTIFACT, sdg=PROCESSOR, engineering-object={category=CONFWF, domain=CUBAS, short-label-pattern=Sum_Spm_Generate, file-type-pattern=oaw}}
        category=AR_OBJECT, sdg=DEFAULT_IN, ecuc-definition=Spm
