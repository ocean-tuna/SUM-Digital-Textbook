AUTOSAR XML (schema 4-0-3)
# COPYRIGHT RESERVED, 2021 ETAS GmbH. All rights reserved.
# The reproduction, distribution and utilization of this document as well as
# the communication of its contents to others without explicit authorization
# is prohibited. Offenders will be held liable for the payment of damages.
# All rights reserved in the event of the grant of a patent, utility model or
# design.
package /AUTOSAR_Diag_Diag/EcucModuleDefs
  module definition Diag [0..1]: category=VENDOR_SPECIFIC_MODULE_DEFINITION, refined-module-def=Diag, variants pre-compile/post-build  # Configuration of the Diag module.
    container DiagConfigSet: multiple-configuration-container=true  # Defines the data set used during Pre-compile for the DIAG module.
      container CommChannels  # Communication channels configuration
        container CommChannel [1..*]  # Communication channel
          choice reference CommChannelRef: set at pre-compile in variant pre-compile / post-build in variant post-build, origin=ETAS:1.0.0:2015-05-04, destination=[ComMChannel, ComMChannel, ComMChannel, ComMChannel]  # Reference to Communication Channel configuration
    container DiagGeneral  # General configuration of the DIAG module.
      integer EcuAddress: 1..255, set at pre-compile in variant pre-compile / post-build in variant post-build, origin=ETAS:1.0.0:2015-05-04, default-value=16  # ECU Address
      integer MecInitialValue: 1..254, set at pre-compile in variant pre-compile / post-build in variant post-build, origin=ETAS:1.0.0:2015-05-04, default-value=254  # Manufacturer Enable Counter Initial Value
      integer PermitExecutionMask: 0..255, set at pre-compile in variant pre-compile / post-build in variant post-build, origin=ETAS:1.0.0:2015-05-04, default-value=254  # PermitExecution mask to start execution of the DIAG module.
      boolean RMBA_Support: set at pre-compile in variant pre-compile / post-build in variant post-build, origin=ETAS:1.0.0:2015-05-04, default-value=true  # RMBA_Support is used to check if ECU supports Read Memory by Address service of DCM.
      boolean DDDI_Support: set at pre-compile in variant pre-compile / post-build in variant post-build, origin=ETAS:1.0.0:2015-05-04, default-value=true  # DDDI_Support is used to check if ECU supports Dynamically Define Data By Memory Address service.
      boolean DiagGenerateInitRunnable: set at post-compile in variant pre-compile / post-build in variant post-build, origin=ETAS:1.0.0:2015-05-04, default-value=false  # DiagGenerateInitRunnable is used to allow the generation of a periodic runnable that calls the initialization function DIAG_Init only the first time it is invoked.
      boolean MecStorageInHsm: set at pre-compile in variant pre-compile / post-build in variant post-build, origin=ETAS:1.0.0:2015-05-04, default-value=true  # Selects MEC storage variant. TRUE: MEC is stored in HSM Secure Data Store (uses LLSI calls). FALSE: MEC is stored in NvM (uses NvM RAM mirror). Default is TRUE (HSM).
      float HsmMecWriteTimeout [0..1]: 100.0..10000.0, set at pre-compile, origin=ETAS:1.0.0:2015-05-04, default-value=200.0  # Timeout in milliseconds for HSM MEC write polling (CYS4008 Step K). Must be at least 100ms. Only used when MecStorageInHsm is TRUE.
      boolean Sum_Diag_EnableDID_E0CC: set at post-compile in variant pre-compile / post-build in variant post-build, origin=ETAS:1.0.0:2015-05-04, default-value=false  # Sum_Diag_EnableDID_E0CC is used to enable/disable support for DID 0xE0CC (Service Discovery Learning Table Status). When enabled, interfaces and code for DID E0CC are generated. When disabled, SrvcMgr provides alternative implementation.
      float DIAG_TE_Runnable_DIAG_Init_Period [0..1]: 1.0..10000.0, set at pre-compile, origin=ETAS:1.0.0:2015-05-04, default-value=1000.0  # DIAG_TE_Runnable_DIAG_Init_Period is used to specify the periodicity, in milliseconds, of the initialization runnable entity Runnable_DIAG_Init.
      float DIAG_TE_Main_Period: 1.0..10000.0, set at pre-compile, origin=ETAS:1.0.0:2015-05-04, default-value=100.0  # Periodicity value of DiagMain runnable in milliseconds.
      float DIAG_TE_Shutdown_Permission_Period: 1.0..10000.0, set at pre-compile, origin=ETAS:1.0.0:2015-05-04, default-value=100.0  # Periodicity value of ShutdownPermission runnable in milliseconds.
      float DIAG_TE_BswM_ModeUser_Period: 1.0..10000.0, set at pre-compile, origin=ETAS:1.0.0:2015-05-04, default-value=100.0  # Periodicity value of BswMModeUser runnable in milliseconds.
      float DIAG_TE_MEC_Handler_Period: 1.0..10000.0, set at pre-compile, origin=ETAS:1.0.0:2015-05-04, default-value=100.0  # Periodicity value of MecHandler runnable in milliseconds.
      float DIAG_TE_OTA_PSF_Period: 1.0..10000.0, set at pre-compile, origin=ETAS:1.0.0:2015-05-04, default-value=100.0  # Periodicity value of OtaPsf runnable in milliseconds.
      reference DIAG_DID_F1A0_MEC_Reference: set at pre-compile, destination=DcmDspData  # Reference to DCM MEC value Data
      reference DIAG_DID_F1B0_Reference [0..1]: set at pre-compile, destination=DcmDspData  # Reference to DCM DID F1B0 Data
      reference DIAG_DID_E0CC_Reference [0..1]: set at pre-compile, destination=DcmDspData  # Reference to DCM DID E0CC (Service Discovery Learning Table Status) Data
      reference DIAG_MEC_NvMRef: set at pre-compile, destination=NvMBlockDescriptor  # Reference to NvM MEC NvMBlockDescriptor
      reference DIAG_OTA_PSF_NvMRef: set at pre-compile, destination=NvMBlockDescriptor  # Reference to NvM OTA PSF NvMBlockDescriptor
      choice reference DIAG_BSPMP_RmtProgmActvAuthRef: set at pre-compile, destination=[ComGroupSignal, ComSignal]  # Reference to the Backup System Power Mode Protected : Remote Programming Active Authenticated signal. This signal can be configured as a single signal or as a signal belonging to a group of signals.
      foreign reference DIAG_ServiceBased_OTA_DataTypeMappingSet [0..1]: destination-type=DATA-TYPE-MAPPING-SET  # Foreign reference to the DATA-TYPE-MAPPING-SET in the system extract used for OTA service-based operations. This parameter references the system data type mapping set that defines the structure and format for OTA service-based functionality and data transformations.
      foreign reference DIAG_ServiceBased_OTA_Ref [0..1]: set at pre-compile, origin=RB, destination-type=IMPLEMENTATION-DATA-TYPE-ELEMENT  # The parameter references to the IMPLEMENTATION-DATA-TYPE for Service Based OTA from System Extract from Software-AR-Packages
