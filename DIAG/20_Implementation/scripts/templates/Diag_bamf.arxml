AUTOSAR XML (schema 00049)
package /RB_Manifest
  build action manifest Diag_Manifest
    build action Diag_Validate: category=VALIDATOR, invocation=sdg=[1, true, true, true], follow-up-action=Diag_Generator, required-environment=com_bosch_configfw_bfwaction_oaw
      input-datas:
        {category=ARTIFACT, sdg=PROCESSOR, engineering-object={short-label=Diag_Validate, category=CONFWF, domain=CUBAS, file-type=oaw}}
        category=AR_OBJECT, sdg=DEFAULT_IN, ecuc-definition=Diag
    build action Diag_Generator: category=GENERATOR, invocation=sdg=[1, true, FALSE], predecessor-action=Diag_Validate, required-environment=com_bosch_configfw_bfwaction_oaw
      created-datas:
        {category=ARTIFACT, sdg=[MDF, DEFAULT_OUT], engineering-object={short-label=SUM_Diag_*, category=PJTHDR, domain=CUBAS, file-type=h}}
        {category=ARTIFACT, sdg=[MDF, DEFAULT_OUT], engineering-object={short-label=SUM_Diag_*, category=PJTSWCD, domain=CUBAS, file-type=arxml}}
        {category=ARTIFACT, sdg=[MDF, DEFAULT_OUT], engineering-object={short-label=SUM_Diag_*, category=PJTSRC, domain=CUBAS, file-type=c}}
      input-datas:
        {category=ARTIFACT, sdg=PROCESSOR, engineering-object={short-label=Diag_Generate, category=CONFWF, domain=CUBAS, file-type=oaw}}
        category=AR_OBJECT, sdg=DEFAULT_IN, ecuc-definition=Diag
